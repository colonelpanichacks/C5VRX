/**
 * video.c - Realtime MODEM_DIAG -> PARLIO RX -> 16K ring -> Phase5 TX -> DAC.
 *
 * Implements the complete production datapath for C5VRX-3:
 *
 *   MODEM_DIAG full Q4/I4 @ 40 MS/s
 *     -> PARLIO RX POS edge @ 40 MHz
 *     -> 16 KiB cyclic raw DMA ring (HP SRAM)
 *     -> PARLIO TX @ 40 MHz + Phase5 TX BitScrambler (fm.bsasm)
 *     -> [D,D] 6-bit CVBS @ 20 MS/s unique / 40 MHz DAC clock
 *     -> 6-bit resistor DAC
 *
 * Reference: Seamless Golden 16K (build-golden-notel) -- proven best live build.
 *
 * Fixed production constants (NOT configurable at runtime):
 *   IQ rate:        40 MHz
 *   DAC rate:       40 MHz physical ([D,D] = 20 MS/s unique CVBS)
 *   Ring:           16384 bytes (HP SRAM, DMA-aligned)
 *   Pedestal:       20   (hardcoded in FM LUT)
 *   Gain:           2    (hardcoded in FM LUT)
 *   Polarity:       current-minus-previous (hardcoded in FM LUT)
 *   RX sample edge: POS
 *   TX shift edge:  NEG
 *   BS EOF:         downstream (PARLIO TX loop never generates downstream EOF)
 *   BS tail:        0 bytes
 *
 * DMA owns sample pacing; tasks handle AGC, buttons and console commands.
 */

#include "video.h"
#include "rf.h"
#include "buzzer.h"
#include "status_led.h"
#include "preview.h"
#include "menu_font.h"
#include "menu_raster.h"
#include "range_control.h"
#include "arc_controller.h"
#include "hal/parlio_ll.h"
#include "hal/usb_serial_jtag_ll.h"

#include <stdint.h>
#include <string.h>
#include <math.h>
#include <fcntl.h>
#include <unistd.h>

#include "driver/usb_serial_jtag_vfs.h"
#include "driver/bitscrambler.h"
#include "driver/gpio.h"
#include "driver/parlio_rx.h"
#include "driver/parlio_tx.h"
#include "esp_attr.h"
#include "esp_cache.h"
#include "esp_log.h"
#include "esp_rom_sys.h"
#include "esp_timer.h"
#include "freertos/FreeRTOS.h"
#include "freertos/queue.h"
#include "freertos/task.h"
#include "soc/parl_io_struct.h"
#include "soc/bitscrambler_struct.h"
#include "soc/ahb_dma_struct.h"
#include "soc/pcr_struct.h"
#include "soc/soc.h"
#include "hal/gdma_channel.h"
#include "modem/modem_syscon_reg.h"
#include "hal/dma_types.h"
#include "esp_clock_output.h"

/* Hardware diagnostic counters in IRAM to measure transport hiccups without printf spam */
typedef struct {
    uint32_t parl_rx_wovf_count;
    uint32_t parl_tx_rempty_count;
    uint32_t parl_tx_eof_count;
    uint32_t gdma_in_fault_count;
    uint32_t gdma_out_fault_count;
    uint32_t bs_fifo_empty_count;
    uint32_t bs_eof_overload_count;
    uint32_t lag_event_count;
    uint32_t near_gain_event_count;
    uint32_t near_phy_event_count;
    uint32_t gain_quality_drop_count;
    uint32_t user_lag_mark_count;
    uint32_t checks;
} hw_transport_counters_t;

enum {
    LAG_EVT_PARLIO_TX_REMPTY = 1u << 0,
    LAG_EVT_PARLIO_RX_WOVF   = 1u << 1,
    LAG_EVT_PARLIO_TX_EOF    = 1u << 2,
    LAG_EVT_GDMA_IN_FAULT    = 1u << 3,
    LAG_EVT_GDMA_OUT_FAULT   = 1u << 4,
    LAG_EVT_BS_EOF_OVERLOAD  = 1u << 5,
};

/* f30297b: every RF PHY write kind is timestamped so transport faults can be
 * correlated against gain/filter/offset writes (issue #28). */
enum {
    PHY_WRITE_NONE   = 0,
    PHY_WRITE_GAIN   = 1,
    PHY_WRITE_BW     = 2,
    PHY_WRITE_OFFSET = 3,
};

#define LAG_EVENT_LOG_SIZE 12u
#define GDMA_IN_FAULT_MASK  0xfcu /* ERR_EOF, DSCR_ERR/EMPTY, FIFO OVF/UDF, AHB response */
#define GDMA_OUT_FAULT_MASK 0x7cu /* DSCR_ERR, TOTAL_EOF, FIFO OVF/UDF, AHB response */

typedef struct {
    int64_t time_us;
    uint32_t seq;
    uint32_t flags;
    uint16_t rx_off;
    uint16_t tx_off;
    uint8_t gain;
    uint8_t agc_state;
} lag_event_t;

static volatile hw_transport_counters_t s_hw_counters;
static lag_event_t s_lag_events[LAG_EVENT_LOG_SIZE];
static volatile uint32_t s_lag_event_head;
static volatile int64_t s_last_gain_write_us;
static volatile int64_t s_last_phy_write_us;
static volatile uint8_t s_last_phy_write_kind;
static volatile int64_t s_last_transport_event_us;
static volatile uint32_t s_last_transport_flags;
static volatile uint32_t s_last_gain_drop_transition;
static volatile int64_t s_last_user_lag_mark_us;
static volatile uint32_t s_gain_transition_count;

/* fm.bsasm program symbol generated by target_bitscrambler_add_src(). */
BITSCRAMBLER_PROGRAM(s_fm_program, "fm");
BITSCRAMBLER_PROGRAM(s_fm_traj_program, "fm_traj");

/* Runtime demod selection for the A/B switch (console 'T'): boot default is
 * the proven Phase5 program; Trajectory v2 is the opt-in weak-signal
 * experiment. start_flight_demodulator() honors this so the selection also
 * survives menu close (which reloads the program). */
static bool s_traj_demod_active;

/* ----- Fixed production constants ----- */
#define IQ_RATE_HZ       40000000u   /* MODEM_DIAG / PARLIO RX clock */
#define DAC_RATE_HZ      40000000u   /* PARLIO TX clock ([D,D] = 20 MS/s unique) */
#define RAW_RING_BYTES   16384u      /* 16384 byte cyclic ring (16 KiB Seamless Golden) */
#define DAC_IDLE_CODE    20u         /* Black/blanking pedestal; sync is 0 */
#define BOOT_BTN_GPIO    GPIO_NUM_28 /* Seeed Studio XIAO ESP32-C5 BOOT Button */
#define CONTROL_SAMPLE_BYTES 4092u   /* one complete, already-finished GDMA descriptor */
#define GAIN_SETTLE_TICKS 10         /* 500 ms decision hold after a classic-path gain write */


static volatile video_standard_t s_video_std = VIDEO_STD_NTSC;
/* Semantic sync scorer state (upstream range v2): CVBS H-sync quality on the
 * demodulated Phase5 waveform, plus the PAL/NTSC line-period vote. */
static volatile video_standard_t s_detected_video_std = VIDEO_STD_NTSC;
static volatile bool s_detected_video_std_valid;
static volatile uint8_t s_video_std_pal_score;
static volatile uint8_t s_video_std_ntsc_score;
static volatile uint16_t s_last_line_period_20m;
static volatile uint16_t s_last_sync_width_20m;
static volatile int s_last_sync_quality;
static volatile int s_last_sync_age_ticks; /* 50 ms ticks since last fresh semantic sync */
static volatile int s_last_winding_permille;
static volatile int s_last_strong_winding_permille;
/* Legacy lock veto (range v2 surgical fix): mirror of the confirmed-lock
 * boolean that gates the buzzer LOCK jingle and [CARRIER] prints. While it
 * is true, the upstream range controller runs observation-only and must not
 * issue any gain write. One-tick (50 ms) stale by design: the lock block
 * runs after the controller in the loop, so the veto applies from the tick
 * after lock confirms -- conservative in the safe direction. */
static volatile bool s_legacy_lock_confirmed;
static volatile int s_last_dc_i_x100;
static volatile int s_last_dc_q_x100;
static volatile int s_last_iq_skew_permille;
static volatile int s_last_iq_cross_permille;
static QueueHandle_t s_menu_commands;
static bitscrambler_handle_t s_flight_bs;

/* Cache synchronization helpers for DMA buffers and descriptors on ESP32-C5.
 * Aligns address down and size up to 64-byte cache line boundaries so esp_cache_msync
 * never fails with ESP_ERR_INVALID_ARG on unaligned descriptors or buffers. */
static inline void sync_dma_c2m(const void *addr, size_t size)
{
    if (!addr || size == 0) return;
    uint32_t start = (uint32_t)addr & ~(64u - 1u);
    uint32_t end = ((uint32_t)addr + size + 63u) & ~(64u - 1u);
    (void)esp_cache_msync((void *)start, end - start,
                          ESP_CACHE_MSYNC_FLAG_DIR_C2M | ESP_CACHE_MSYNC_FLAG_UNALIGNED);
}

static inline void sync_dma_m2c(const void *addr, size_t size)
{
    if (!addr || size == 0) return;
    uint32_t start = (uint32_t)addr & ~(64u - 1u);
    uint32_t end = ((uint32_t)addr + size + 63u) & ~(64u - 1u);
    (void)esp_cache_msync((void *)start, end - start,
                          ESP_CACHE_MSYNC_FLAG_DIR_M2C | ESP_CACHE_MSYNC_FLAG_UNALIGNED);
}

/* Timing and descriptors are immutable while running; only text pixels change.
 * This raster is never linked to the RF ring. */
static DMA_ATTR __attribute__((aligned(64))) menu_raster_t s_menu_raster;
static DMA_ATTR __attribute__((aligned(64))) dma_descriptor_t s_menu_nodes[MENU_MAX_NODES];
static unsigned s_menu_node_count;
static volatile bool s_menu_active;
static volatile bool s_menu_boot_btn_enabled = true;
static volatile int s_menu_cursor;
static int s_menu_timeout_ticks;

/* TX GPIO mapping: 6-bit resistor DAC.
 * Order: DAC bit 0 (LSB) .. DAC bit 5 (MSB) on data_gpio_nums[0..5].
 * Bits 6..7 unused (set to -1).
 * Verified against C5VRX-2 realtime.c (standard 8-bit PARLIO TX, non-parlio4). */
static const int s_dac_gpio[8] = {23, 24, 11, 12, 8, 9, -1, -1};

_Static_assert(IQ_RATE_HZ == 40000000u, "IQ rate must be 40 MHz");
_Static_assert(DAC_RATE_HZ == 40000000u, "DAC rate must be 40 MHz");
_Static_assert(RAW_RING_BYTES == 16384u, "Ring must be exactly 16384 bytes");

static const char *TAG = "c5vrx3_video";

/* DMA-aligned ring buffer in HP SRAM.
 * RX GDMA writes at 40 MB/s; TX GDMA reads at 40 MB/s.
 * TX starts one block (4096 bytes = 102.4 µs) behind RX; they share
 * PLL_F240M/6, so separation cannot drift during normal operation. */
static DMA_ATTR __attribute__((aligned(64))) uint8_t s_raw_ring[RAW_RING_BYTES];

static parlio_rx_unit_handle_t      s_rx;
static parlio_rx_delimiter_handle_t s_rx_delimiter;
static parlio_tx_unit_handle_t      s_tx;

/* ----- PARLIO RX setup ----- */

static esp_err_t prepare_rx(void)
{
    /* Proven PARLIO RX config with clean internal SPLL clock */
    const parlio_rx_unit_config_t cfg = {
        .trans_queue_depth = 1u,
        .max_recv_size     = sizeof(s_raw_ring),
        .dma_burst_size    = 32u,
        .data_width        = 8u,
        .clk_src           = PARLIO_CLK_SRC_DEFAULT,
        .ext_clk_freq_hz   = 0u,
        .exp_clk_freq_hz   = IQ_RATE_HZ,
        .clk_in_gpio_num   = -1,
        .clk_out_gpio_num  = -1,
        .valid_gpio_num    = -1,
        /* GPIO order must match s_iq_pins[] in rf.c:
         * Q[9:6] on GPIO 1,0,2,7 then I[9:6] on GPIO 10,5,3,4.
         * OUI-SPY mod: Q[8] on GPIO2 (MTMS pad); GPIO25 stays with the buzzer. */
        .data_gpio_nums    = {
            GPIO_NUM_1, GPIO_NUM_0, GPIO_NUM_2, GPIO_NUM_7,
            GPIO_NUM_10, GPIO_NUM_5, GPIO_NUM_3, GPIO_NUM_4,
        },
        .flags = {
            .free_clk    = true,   /* RX clock is derived from PHY, not gated */
            .clk_gate_en = false,
            .allow_pd    = false,
        },
    };
    esp_err_t err = parlio_new_rx_unit(&cfg, &s_rx);
    if (err != ESP_OK) return err;

    /* Soft delimiter in infinite (partial_rx_en) mode.
     * POS sample edge -- proven correct for internal clock. */
    const parlio_rx_soft_delimiter_config_t delim_cfg = {
        .sample_edge  = PARLIO_SAMPLE_EDGE_POS,
        .bit_pack_order = PARLIO_BIT_PACK_ORDER_LSB,
        .eof_data_len = sizeof(s_raw_ring),
        .timeout_ticks = 0u,
    };
    err = parlio_new_rx_soft_delimiter(&delim_cfg, &s_rx_delimiter);
    if (err != ESP_OK) return err;

    return parlio_rx_unit_enable(s_rx, false);
}

/* ----- PARLIO TX setup ----- */

static esp_err_t prepare_tx(void)
{
    /* Proven PARLIO TX config from Seamless Golden 16K reference.
     * 8-bit data width, 40 MHz output, NEG shift edge, LSB packing.
     * The explicitly owned BitScrambler attaches to TX (C5 has one BS). */
    const parlio_tx_unit_config_t cfg = {
        .clk_src              = PARLIO_CLK_SRC_DEFAULT,
        .clk_in_gpio_num      = -1,
        .input_clk_src_freq_hz = 0u,
        .output_clk_freq_hz   = DAC_RATE_HZ,
        .data_width           = 8u,
        .data_gpio_nums       = {
            s_dac_gpio[0], s_dac_gpio[1], s_dac_gpio[2], s_dac_gpio[3],
            s_dac_gpio[4], s_dac_gpio[5], s_dac_gpio[6], s_dac_gpio[7],
        },
        .clk_out_gpio_num  = -1,
        .valid_gpio_num    = -1,
        .valid_start_delay = 0,
        .valid_stop_delay  = 0,
        .trans_queue_depth = 1u,
        .max_transfer_size = sizeof(s_raw_ring),
        .dma_burst_size    = 32u,
        .shift_edge        = PARLIO_SHIFT_EDGE_NEG,   /* FIXED: NEG (RX is POS) */
        .bit_pack_order    = PARLIO_BIT_PACK_ORDER_LSB,
    };
    esp_err_t err = parlio_new_tx_unit(&cfg, &s_tx);
    if (err != ESP_OK) return err;

    /* Own the demodulator explicitly: the IDF TX disable path does not
     * disable a decorated BitScrambler on an interrupted infinite loop. */
    const bitscrambler_config_t bs_cfg = {
        .dir = BITSCRAMBLER_DIR_TX,
        .attach_to = SOC_BITSCRAMBLER_ATTACH_PARL_IO,
    };
    err = bitscrambler_new(&bs_cfg, &s_flight_bs);
    if (err != ESP_OK) return err;

    return parlio_tx_unit_enable(s_tx);
}

/* ----- Start RX cyclic ring ----- */

static esp_err_t start_rx(void)
{
    esp_err_t err = parlio_rx_soft_delimiter_start_stop(s_rx, s_rx_delimiter, true);
    if (err != ESP_OK) return err;
    const parlio_receive_config_t cfg = {
        .delimiter = s_rx_delimiter,
        .flags = {
            .partial_rx_en   = true,
            .indirect_mount  = false,
        },
    };
    return parlio_rx_unit_receive(s_rx, s_raw_ring, sizeof(s_raw_ring), &cfg);
}

/* ----- Start TX loop ----- */

static esp_err_t start_tx(void)
{
    /* Phase5 LUT is embedded in fm.bsasm -- no runtime bitscrambler_load_lut().
     * Hardware oracle v9 proved embedded LUT is byte-exact at 20 MS/s;
     * a separately preloaded LUT is NOT retained by the active PARLIO TX run. */
    const parlio_transmit_config_t cfg = {
        .idle_value          = DAC_IDLE_CODE,
        .bitscrambler_program = NULL, /* s_flight_bs is controlled explicitly */
        .flags.loop_transmission = true,  /* Infinite -- never generates downstream EOF */
    };
    /* TX reads sizeof(s_raw_ring) * 8 bits, then loops.
     * loop_transmission=true means PARLIO TX never stops; the BitScrambler
     * with eof_on=downstream therefore runs uninterrupted forever. */
    return parlio_tx_unit_transmit(s_tx, s_raw_ring,
                                   sizeof(s_raw_ring) * 8u, &cfg);
}

static int s_rx_dma_ch = -1;
static int s_tx_dma_ch = -1;

/* GDMA link descriptors must live in DMA-capable internal SRAM. Use the SoC
 * header bounds instead of a hardcoded literal: on ESP32-C5 that range is
 * [0x40800000, 0x40860000) per soc/soc.h -- the upper 128 KB of the 512 KB
 * internal SRAM is NOT DMA-addressable, so a wider bound would admit
 * descriptor addresses the AHB GDMA can never fetch. */
static inline bool gdma_dscr_addr_valid(uint32_t addr)
{
    return addr >= SOC_DMA_LOW && addr < SOC_DMA_HIGH;
}

static inline uint32_t get_rx_dma_offset(uint32_t *out_dscr_addr)
{
    if (s_rx_dma_ch < 0 || s_rx_dma_ch >= 3) return 0;
    uint32_t dscr_addr = AHB_DMA.channel[s_rx_dma_ch].in.in_dscr_bf0.val;
    if (out_dscr_addr) *out_dscr_addr = dscr_addr;
    if (gdma_dscr_addr_valid(dscr_addr)) {
        dma_descriptor_t *dscr = (dma_descriptor_t *)(uintptr_t)dscr_addr;
        uint8_t *buf = (uint8_t *)dscr->buffer;
        if (buf >= s_raw_ring && buf < s_raw_ring + sizeof(s_raw_ring)) {
            return (uint32_t)(buf - s_raw_ring);
        }
    }
    return 0;
}

static inline uint32_t get_tx_dma_offset(uint32_t *out_dscr_addr)
{
    if (s_tx_dma_ch < 0 || s_tx_dma_ch >= 3) return 0;
    uint32_t dscr_addr = AHB_DMA.channel[s_tx_dma_ch].out.out_dscr_bf0.val;
    if (out_dscr_addr) *out_dscr_addr = dscr_addr;
    if (gdma_dscr_addr_valid(dscr_addr)) {
        dma_descriptor_t *dscr = (dma_descriptor_t *)(uintptr_t)dscr_addr;
        uint8_t *buf = (uint8_t *)dscr->buffer;
        if (buf >= s_raw_ring && buf < s_raw_ring + sizeof(s_raw_ring)) {
            return (uint32_t)(buf - s_raw_ring);
        }
    }
    return 0;
}

const uint8_t *video_tap_iq_ring(size_t *size_bytes, uint32_t *rx_offset)
{
    if (size_bytes) *size_bytes = sizeof(s_raw_ring);
    if (rx_offset) *rx_offset = get_rx_dma_offset(NULL);
    return s_raw_ring;
}

#define MAX_RING_DESCRIPTORS 16

typedef struct {
    dma_descriptor_t *dscr;
    uint8_t *buffer;
    uint32_t length;
} ring_dscr_node_t;

static ring_dscr_node_t s_rx_dscr_nodes[MAX_RING_DESCRIPTORS];
static int s_rx_dscr_count = 0;

static ring_dscr_node_t s_tx_dscr_nodes[MAX_RING_DESCRIPTORS];
static int s_tx_dscr_count = 0;

static inline int find_dscr_index(const ring_dscr_node_t *nodes, int count, uint32_t addr)
{
    for (int i = 0; i < count; i++) {
        if ((uintptr_t)nodes[i].dscr == addr) return i;
    }
    return -1;
}

static int patch_descriptors_clear_eof(int dma_ch, bool is_rx)
{
    if (dma_ch < 0 || dma_ch >= 3) return 0;
    uint32_t first_addr = is_rx ? AHB_DMA.channel[dma_ch].in.in_dscr_bf0.val
                                : AHB_DMA.channel[dma_ch].out.out_dscr_bf0.val;
    if (!gdma_dscr_addr_valid(first_addr)) return 0;

    dma_descriptor_t *curr = (dma_descriptor_t *)(uintptr_t)first_addr;
    int count = 0;
    if (is_rx) s_rx_dscr_count = 0;
    else s_tx_dscr_count = 0;

    while (curr && count < MAX_RING_DESCRIPTORS) {
        curr->dw0.suc_eof = 0;
        sync_dma_c2m(curr, sizeof(dma_descriptor_t));

        if (is_rx) {
            s_rx_dscr_nodes[count].dscr = curr;
            s_rx_dscr_nodes[count].buffer = (uint8_t *)curr->buffer;
            s_rx_dscr_nodes[count].length = curr->dw0.size ? curr->dw0.size : 4092u;
        } else {
            s_tx_dscr_nodes[count].dscr = curr;
            s_tx_dscr_nodes[count].buffer = (uint8_t *)curr->buffer;
            s_tx_dscr_nodes[count].length = curr->dw0.size ? curr->dw0.size : 4092u;
        }

        curr = curr->next;
        count++;
        if ((uintptr_t)curr == first_addr) break;
        if (!gdma_dscr_addr_valid((uint32_t)(uintptr_t)curr)) break;
    }
    if (is_rx) s_rx_dscr_count = count;
    else s_tx_dscr_count = count;

    __asm__ __volatile__("fence rw, rw" ::: "memory");
    return count;
}

/* Pick a descriptor that RX has already completed, rather than sampling a
 * fixed address that GDMA may be overwriting at the same instant. This keeps
 * AGC/coherence decisions based on one coherent 256-byte RF snapshot. */
static uint8_t *get_completed_rx_sample_window(size_t bytes)
{
    if (s_rx_dma_ch < 0 || s_rx_dma_ch >= 3 || s_rx_dscr_count < 2) {
        return s_raw_ring;
    }

    uint32_t current_addr = AHB_DMA.channel[s_rx_dma_ch].in.in_dscr_bf0.val;
    int current_idx = find_dscr_index(s_rx_dscr_nodes, s_rx_dscr_count, current_addr);
    if (current_idx < 0) {
        return s_raw_ring;
    }

    for (int back = 1; back < s_rx_dscr_count; ++back) {
        int idx = (current_idx - back + s_rx_dscr_count) % s_rx_dscr_count;
        uint8_t *buf = s_rx_dscr_nodes[idx].buffer;
        uint32_t len = s_rx_dscr_nodes[idx].length;
        if (buf && len >= bytes &&
            buf >= s_raw_ring && (buf + bytes) <= (s_raw_ring + sizeof(s_raw_ring))) {
            return buf;
        }
    }
    return s_raw_ring;
}

/* ------------------------------------------------------------------ *
 * Raw ring API for main/grab.c (the composite frame grabber). Same   *
 * passive discipline as the tap above: consumers read, never write.  *
 * ------------------------------------------------------------------ */

const uint8_t *video_rx_ring(void)
{
    return s_raw_ring;
}

bool video_rx_write_offset(uint32_t *offset)
{
    if (s_rx_dma_ch < 0 || s_rx_dma_ch >= 3 || s_rx_dscr_count < 2) return false;
    uint32_t cur = AHB_DMA.channel[s_rx_dma_ch].in.in_dscr_bf0.val;
    int idx = find_dscr_index(s_rx_dscr_nodes, s_rx_dscr_count, cur);
    if (idx < 0 || !s_rx_dscr_nodes[idx].buffer) return false;
    *offset = (uint32_t)(s_rx_dscr_nodes[idx].buffer - s_raw_ring);
    return true;
}

uint32_t video_rx_max_descriptor(void)
{
    uint32_t m = 0u;
    for (int i = 0; i < s_rx_dscr_count; ++i)
        if (s_rx_dscr_nodes[i].length > m) m = s_rx_dscr_nodes[i].length;
    return m ? m : CONTROL_SAMPLE_BYTES;
}

/* =========================================================================
 * Upstream range v2: Phase5 semantic CVBS sync scorer + winding observer
 * (e7e0a28, 0df90a5, e36ec0a). Observation-only: the realtime BitScrambler
 * remains the sole live demodulator and these helpers never write RF/PHY.
 * ========================================================================= */

/* Exact Phase5 state decode mirrored from the embedded fm.bsasm LUT.  The
 * detector is observation-only: the realtime BitScrambler remains the sole
 * live demodulator. */
static const uint8_t s_phase5_state_lut[256] = {
     4,  6,  7,  7,  7,  8,  8,  8, 24, 24, 24, 25, 25, 25, 26, 28,
     2,  4,  5,  6,  6,  7,  7,  7, 25, 25, 25, 26, 26, 27, 28, 30,
     1,  3,  4,  5,  5,  6,  6,  6, 26, 26, 26, 27, 27, 28, 29, 31,
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    12, 10,  9,  9,  9,  8,  8,  8, 24, 24, 24, 23, 23, 23, 22, 20,
};

/* Bit i is 1 when the production fm.bsasm delta LUT maps that
 * (previous_phase5,current_phase5) pair to DAC code <= 8.  This compact mask
 * lets the control task recognize real H-sync tips without duplicating the
 * 1024-entry output LUT or using floating point. */
static const uint8_t s_phase5_sync_mask[128] = {
    0x00, 0x00, 0x80, 0x3f, 0x00, 0x00, 0x00, 0xff, 0x00, 0x00, 0x00, 0xfe, 0x03, 0x00, 0x00, 0xfc,
    0x07, 0x00, 0x00, 0xf8, 0x0f, 0x00, 0x00, 0xf0, 0x1f, 0x00, 0x00, 0xe0, 0x3f, 0x00, 0x00, 0xc0,
    0x3f, 0x00, 0x00, 0x80, 0xff, 0x00, 0x00, 0x00, 0xfe, 0x00, 0x00, 0x00, 0xfc, 0x01, 0x00, 0x00,
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    0x00, 0x00, 0xf8, 0x07, 0x00, 0x00, 0xf0, 0x0f, 0x00, 0x00, 0xe0, 0x1f, 0x00, 0x00, 0xc0, 0x1f,
};

static inline bool phase5_pair_is_sync(uint8_t previous, uint8_t current)
{
    unsigned index = ((unsigned)previous << 5u) | current;
    return (s_phase5_sync_mask[index >> 3u] & (1u << (index & 7u))) != 0u;
}

static uint32_t s_receive_generation;

static void video_standard_detector_reset(void)
{
    ++s_receive_generation;
    s_video_std_pal_score = 0;
    s_video_std_ntsc_score = 0;
    s_detected_video_std_valid = false;
    s_last_line_period_20m = 0;
    s_last_sync_width_20m = 0;
    s_last_sync_quality = 0;
}

static void video_standard_vote(video_standard_t standard, uint16_t period)
{
    s_last_line_period_20m = period;
    if (standard == VIDEO_STD_PAL) {
        if (s_video_std_pal_score < 8u) ++s_video_std_pal_score;
        if (s_video_std_ntsc_score) --s_video_std_ntsc_score;
    } else {
        if (s_video_std_ntsc_score < 8u) ++s_video_std_ntsc_score;
        if (s_video_std_pal_score) --s_video_std_pal_score;
    }

    if (s_video_std_pal_score >= 3u &&
        s_video_std_pal_score >= s_video_std_ntsc_score + 2u) {
        s_detected_video_std = VIDEO_STD_PAL;
        s_detected_video_std_valid = true;
    } else if (s_video_std_ntsc_score >= 3u &&
               s_video_std_ntsc_score >= s_video_std_pal_score + 2u) {
        s_detected_video_std = VIDEO_STD_NTSC;
        s_detected_video_std_valid = true;
    }
}

static const char *video_standard_name(video_standard_t standard)
{
    return standard == VIDEO_STD_PAL ? "PAL 625i" : "NTSC 525i";
}

/* Observe one complete, stable RX descriptor. Production Phase5 consumes the
 * odd byte of each 16-bit read, so this mirrors the same 20 MS/s sample
 * cadence. Valid H-sync low runs are about 94 samples wide. Their start-to-
 * start period is ~1271 samples for NTSC and exactly 1280 for PAL. */
static int video_semantic_observe(const uint8_t *raw, size_t bytes, size_t ring_offset)
{
    if (!raw || bytes < 3000u) return 0;

    const size_t first = (ring_offset & 1u) ? 0u : 1u;
    if (first + 2u >= bytes) return 0;

    uint8_t previous = s_phase5_state_lut[raw[first]];
    bool in_sync = false;
    unsigned run_start = 0;
    unsigned run_len = 0;
    unsigned starts[4];
    unsigned widths[4];
    unsigned start_count = 0;
    unsigned out_index = 1;

    for (size_t i = first + 2u; i < bytes; i += 2u, ++out_index) {
        uint8_t current = s_phase5_state_lut[raw[i]];
        bool low = phase5_pair_is_sync(previous, current);
        previous = current;

        if (low) {
            if (!in_sync) {
                in_sync = true;
                run_start = out_index;
                run_len = 1u;
            } else {
                ++run_len;
            }
        } else if (in_sync) {
            /* Real horizontal sync is ~94 samples at 20 MS/s.  Keep the broad
             * physical acceptance window for robustness, but score closeness
             * to the real pulse width instead of treating every accepted low
             * run as equally convincing. */
            if (run_len >= 70u && run_len <= 125u && start_count < 4u) {
                starts[start_count] = run_start;
                widths[start_count] = run_len;
                ++start_count;
            }
            in_sync = false;
            run_len = 0u;
        }
    }

    unsigned width_error_sum = 0;
    for (unsigned i = 0; i < start_count; ++i) {
        unsigned w = widths[i];
        width_error_sum += w > 94u ? w - 94u : 94u - w;
    }
    unsigned width_error = start_count ? width_error_sum / start_count : 100u;
    int width_score = start_count ? 40 - (int)width_error * 4 : 0;
    if (width_score < 0) width_score = 0;
    s_last_sync_width_20m = start_count ? (uint16_t)widths[0] : 0u;

    int best_period_score = 0;
    bool valid_period = false;
    for (unsigned i = 1; i < start_count; ++i) {
        unsigned period = starts[i] - starts[i - 1u];
        int score = 0;

        if (period >= 1266u && period <= 1275u) {
            unsigned error = period > 1271u ? period - 1271u : 1271u - period;
            score = 60 - (int)error * 8;
            valid_period = true;
            video_standard_vote(VIDEO_STD_NTSC, (uint16_t)period);
        } else if (period >= 1277u && period <= 1284u) {
            unsigned error = period > 1280u ? period - 1280u : 1280u - period;
            score = 60 - (int)error * 8;
            valid_period = true;
            video_standard_vote(VIDEO_STD_PAL, (uint16_t)period);
        }
        if (score > best_period_score) best_period_score = score;
    }

    /* A lone random low pulse can earn at most 40/100.  TRACK/acquisition
     * requires >=60, which means a physically plausible repeated line period
     * must also be present. */
    int quality = width_score + best_period_score;
    if (!valid_period) quality = width_score;
    if (quality > 100) quality = 100;
    s_last_sync_quality = quality;
    return quality;
}

typedef struct {
    int p_median;
    int q_phase;
    int n_clip;
    int n_origin;
    int clip_permille;
    int origin_permille;
    int n_coherent;
    int sum_cross;
    int sum_dot;
    int64_t sum_cross2; /* OUI-SPY: FM phase-swing (modulation) discrimination */
    int64_t sum_p;   /* OUI-SPY: envelope/level metering (kept from our loop) */
    int64_t sum_p2;
    int sum_i;
    int sum_q;
    int sum_i2;
    int sum_q2;
    int sum_iq;
    int dc_i_x100;
    int dc_q_x100;
    int iq_skew_permille;
    int iq_cross_permille;
    int winding_events;
    int winding_triplets;
    int winding_permille;
    int strong_winding_events;
    int strong_winding_triplets;
    int strong_winding_permille;
} control_metrics_t;

static control_metrics_t analyze_control_window(const uint8_t *sample, size_t bytes,
                                                size_t ring_offset)
{
    control_metrics_t m = {0};
    uint16_t hist[129] = {0};
    const size_t production_first = (ring_offset & 1u) ? 0u : 1u;
    int8_t prev_i = 0, prev_q = 0;
    uint8_t prev_phase = 0, prev2_phase = 0;
    int prev_power = 0, prev2_power = 0;

    for (size_t i = 0; i < bytes; ++i) {
        uint8_t byte = sample[i];
        int8_t q = (int8_t)((byte & 0x0fu) << 4) >> 4;
        int8_t in_val = (int8_t)(byte & 0xf0u) >> 4;

        if (in_val == -8 || in_val == 7 || q == -8 || q == 7) ++m.n_clip;
        int i2 = (int)in_val * in_val;
        int q2 = (int)q * q;
        m.sum_i += in_val;
        m.sum_q += q;
        m.sum_i2 += i2;
        m.sum_q2 += q2;
        m.sum_iq += (int)in_val * q;

        int p = i2 + q2;
        const int raw_power = p;
        const uint8_t phase = s_phase5_state_lut[byte];
        m.sum_p += p;
        m.sum_p2 += (int64_t)p * p;
        if (p <= 4) ++m.n_origin;
        if (p > 128) p = 128;
        ++hist[p];

        if (i > 0) {
            int dot = (int)in_val * (int)prev_i + (int)q * (int)prev_q;
            int cross = (int)q * (int)prev_i - (int)in_val * (int)prev_q;
            int abs_cross = cross < 0 ? -cross : cross;
            /* Coherent FM sample: carrier power >= 8, phase delta within +-45 deg */
            if (p >= 8 && dot > 0 && abs_cross <= dot) {
                ++m.n_coherent;
                m.sum_cross += cross;
                m.sum_dot += dot;
                m.sum_cross2 += (int64_t)cross * cross;
            }
        }

        /* fm.bsasm consumes one parity at 20 MS/s. Count exactly those
         * endpoint intervals, while using the skipped 40 MS/s middle sample
         * only as a shadow oracle. */
        bool production_endpoint =
            i >= production_first + 2u &&
            ((i - production_first) & 1u) == 0u;
        if (production_endpoint) {
            bool winding = demod_phase5_endpoint_loses_winding(prev2_phase,
                                                               prev_phase,
                                                               phase);
            ++m.winding_triplets;
            if (winding) ++m.winding_events;
            if (prev2_power >= DEMOD_STRONG_POWER_MIN &&
                prev_power >= DEMOD_STRONG_POWER_MIN &&
                raw_power >= DEMOD_STRONG_POWER_MIN) {
                ++m.strong_winding_triplets;
                if (winding) ++m.strong_winding_events;
            }
        }

        prev2_phase = prev_phase;
        prev_phase = phase;
        prev2_power = prev_power;
        prev_power = raw_power;
        prev_i = in_val;
        prev_q = q;
    }

    unsigned cumulative = 0;
    for (unsigned p = 0; p <= 128u; ++p) {
        cumulative += hist[p];
        if (cumulative >= (bytes + 1u) / 2u) {
            m.p_median = (int)p;
            break;
        }
    }
    m.q_phase = bytes > 1u ? (m.n_coherent * 100) / (int)(bytes - 1u) : 0;
    m.clip_permille = bytes ? (m.n_clip * 1000) / (int)bytes : 0;
    m.origin_permille = bytes ? (m.n_origin * 1000) / (int)bytes : 1000;
    m.winding_permille = m.winding_triplets ?
        (m.winding_events * 1000) / m.winding_triplets : 0;
    m.strong_winding_permille = m.strong_winding_triplets ?
        (m.strong_winding_events * 1000) / m.strong_winding_triplets : 0;
    m.dc_i_x100 = bytes ? (m.sum_i * 100) / (int)bytes : 0;
    m.dc_q_x100 = bytes ? (m.sum_q * 100) / (int)bytes : 0;

    /* These two dimensionless metrics are intentionally cheap. A perfect
     * centered/circular I/Q cloud tends toward zero skew and zero I/Q cross
     * correlation. They let us quantify DC/IQ calibration quality without
     * putting any new calibration routine in the realtime path. */
    int iq_power = m.sum_i2 + m.sum_q2;
    if (iq_power > 0) {
        int skew = m.sum_i2 - m.sum_q2;
        if (skew < 0) skew = -skew;
        int cross = m.sum_iq;
        if (cross < 0) cross = -cross;
        m.iq_skew_permille = (skew * 1000) / iq_power;
        m.iq_cross_permille = (cross * 2000) / iq_power;
    }
    return m;
}

/* =========================================================================
 * Receiver Modes, Dual-Loop AGC, Bandwidth Gearbox, and AFC State
 *
 * Control metrics come from one complete 4092-byte finished RX descriptor
 * (~102.3 us of Q4/I4) every 50 ms (upstream range v2 control window).
 *
 * Direct Q4/I4 vector power: P[n] = I[n]^2 + Q[n]^2
 * Target: P_median in [20, 30] (effective radius ~4.5 - 5.5, phase sigma ~3.3 deg)
 *
 * Fast Overload Rem: Instant drop (-4 or -6) when clip_permille >= 16 AND P_median > 18.
 * FM Phase Coherence: Q_phase = coherent fraction * 100 over the whole window.
 *
 * 3-State Machine:
 *   - SEARCH: No carrier / lost carrier (q_phase < 40%, P_med < 14). Default G=62.
 *   - LEARN:  Probing & centering toward P_median in [20, 30].
 *   - TRACK:  Carrier locked! Hysteresis deadband. ZERO register writes.
 *
 * Modes:
 *   - ANALOG_AGC_SHADOW: Realtime state machine & Q_phase active, physical gain frozen.
 *   - ANALOG_AGC_ACTIVE: Default! ARC vendor-aware receive chain (gain
 *     authority; upstream PR #52). The range v2 controller runs
 *     observation-only beside it (benched); the classic state machine
 *     remains for SHADOW.
 *   - ANALOG_AGC_MANUAL: Fixed gain controlled by user (+ / - keys).
 * ========================================================================= */

typedef enum {
    ANALOG_AGC_SHADOW = 0,
    ANALOG_AGC_ACTIVE = 1,
    ANALOG_AGC_MANUAL = 2,
} analog_agc_mode_t;

typedef enum {
    AGC_STATE_SEARCH = 0,
    AGC_STATE_LEARN  = 1,
    AGC_STATE_TRACK  = 2,
} agc_state_t;

typedef enum {
    BW_GEAR_AUTO = 0, /* Dynamic Bandwidth Adaptation: BW40 normally, BW20 in deep fade */
    BW_GEAR_BW40 = 1, /* Forced BW40 (20 MHz baseband, full color) */
    BW_GEAR_BW20 = 2, /* Forced BW20 (10 MHz baseband, +3 dB sensitivity) */
} bw_gear_mode_t;

typedef enum {
    AFC_MODE_AUTO = 0, /* Auto Carrier Centering: centers within safe +/-1.5 MHz bound when locked */
    AFC_MODE_HOLD = 1, /* AFC Hold: freeze current offset */
    AFC_MODE_OFF  = 2, /* AFC Off: reset to 0 kHz offset */
} afc_mode_t;

static volatile analog_agc_mode_t s_agc_mode = ANALOG_AGC_ACTIVE;
static volatile agc_state_t s_agc_state = AGC_STATE_SEARCH;
static volatile bw_gear_mode_t s_bw_gear_mode = BW_GEAR_AUTO;
/* WBFM instantaneous phase slope contains the video modulation itself.
 * The short-window CFO estimator is useful diagnostics, but it is not yet a
 * calibrated LO-error estimator. Never retune automatically at boot. */
static volatile afc_mode_t s_afc_mode = AFC_MODE_OFF;
static volatile bool s_scan_mode = true;    /* 48-channel auto scanner (default ON at boot) */
static volatile bool s_scan_auto = true;    /* auto-resume scanning after a lost carrier */
/* Dead-channel skip: channels that produced no carrier candidate on
 * SKIP_DEAD_MISS_THRESHOLD consecutive sweeps are scanned with a 50 ms
 * quick dwell instead of the full 200 ms, except every 4th sweep which
 * re-checks them at full dwell so a channel that comes alive is found.
 * Toggle at runtime with console 'k' (authoritative: OFF = flat 200 ms
 * everywhere, the quick path never runs). */
#define SKIP_DEAD_MISS_THRESHOLD 3u
#define BASE_DWELL_TICKS       1u   /* 50 ms base dwell on every channel */
#define SKIP_DWELL_TICKS       1u   /* 50 ms quick dwell on parked channels */
#define CANDIDATE_DWELL_TICKS  4u   /* 200 ms candidate integration */
/* Carrier-offset channel verification: the lock must sit on the channel
 * that actually carries the VTX, not an adjacent-channel image. The
 * channel table's tightest spacing is 19 MHz (B band), so a carrier more
 * than half of that from the tuned center belongs to a neighbouring
 * channel definition. Same-carrier alias names (A1 5865 / B8 5866, ~1 MHz)
 * sit far inside this and still lock, as intended. With +/-2 MHz/tick
 * estimator clamps, the per-hop CFO reset and the +/-45 deg coherence gate,
 * a normal acquisition cannot false-reject: this only vetoes pathological
 * offset declarations and post-lock drift. */
#define LOCK_MAX_OFFSET_KHZ 9500
static uint8_t s_chan_miss[FPV_BAND_COUNT * 8u];
static volatile bool s_skip_dead = true;
static unsigned s_sweep_count;
/* Scanner dwell state. File-scope (not task-local) because the console
 * task must also reset them on 'g': any stale state would truncate the
 * first dwell of a resumed/started scan. s_scan_dwell_extended is the
 * two-tier extension latch (monotonic per dwell). Written by
 * analog_agc_task and console_diag_task, read by analog_agc_task. */
static volatile int s_scan_ticks;
static volatile bool s_scan_dwell_extended;
static volatile bool s_current_bw40 = true;
static volatile uint8_t s_current_gain = 52u;   /* Physical RF gain applied */
static volatile uint8_t s_shadow_gain = 52u;    /* Controller recommended gain */
static volatile int s_last_p_median = 25;
static volatile int s_last_q_phase = 0;
static volatile int s_last_n_clip = 0;
static volatile int s_last_n_origin = 0;
static volatile int s_last_level_dbc = 0;   /* carrier level in decidecibels */
static volatile int s_cfo_khz = 0;              /* Carrier Frequency Offset in kHz */

/* f30297b: tracked RF/PHY write wrappers. Every gain/filter/offset write the
 * control path issues goes through these so issue #28 lag correlation can
 * attribute transport faults to the PHY write that preceded them. OUI-SPY
 * note: our rf.c skips the hidden gain re-assert inside the CFO path when
 * the gain did not change (s_last_forced_gain), so offset writes timestamp
 * the PHY write but do NOT count as gain transitions. */
static void apply_rf_bandwidth(bool bw40)
{
    s_last_phy_write_us = esp_timer_get_time();
    s_last_phy_write_kind = PHY_WRITE_BW;
    s_current_bw40 = bw40;
    rf_set_analog_bandwidth(bw40);
}

static void apply_frequency_offset_khz_tracked(int offset_khz)
{
    int64_t now = esp_timer_get_time();
    s_last_phy_write_us = now;
    s_last_phy_write_kind = PHY_WRITE_OFFSET;
    int forced_before = rf_get_last_forced_gain();
    rf_set_frequency_offset_khz(offset_khz);
    /* Our rf.c re-asserts the forced RX gain after an offset write ONLY when
     * the gain changed (OUI-SPY Q/dc-dip avoidance). Count that hidden gain
     * write for issue #28 correlation exactly when it really happens. */
    if (rf_get_last_forced_gain() != forced_before) {
        s_last_gain_write_us = now;
        ++s_gain_transition_count;
    }
}

static void step_frequency_offset_khz_tracked(int delta_khz)
{
    apply_frequency_offset_khz_tracked(rf_get_frequency_offset_khz() + delta_khz);
}

static void apply_rx_gain_tracked(uint8_t gain)
{
    if (gain < 2u) gain = 2u;
    if (gain > 62u) gain = 62u;
    s_current_gain = gain;
    s_shadow_gain = gain;
    s_last_gain_write_us = esp_timer_get_time();
    s_last_phy_write_us = s_last_gain_write_us;
    s_last_phy_write_kind = PHY_WRITE_GAIN;
    rf_set_rx_gain(true, gain);
    ++s_gain_transition_count;
}

static void record_transport_event(uint32_t flags)
{
    if (!flags) return;
    int64_t now = esp_timer_get_time();
    uint32_t seq = s_lag_event_head + 1u;
    unsigned index = (seq - 1u) % LAG_EVENT_LOG_SIZE;
    uint32_t rx_off = get_rx_dma_offset(NULL);
    uint32_t tx_off = get_tx_dma_offset(NULL);

    s_lag_events[index] = (lag_event_t) {
        .time_us = now,
        .seq = seq,
        .flags = flags,
        .rx_off = (uint16_t)rx_off,
        .tx_off = (uint16_t)tx_off,
        .gain = s_current_gain,
        .agc_state = (uint8_t)s_agc_state,
    };
    s_lag_event_head = seq;
    s_last_transport_event_us = now;
    s_last_transport_flags = flags;
    ++s_hw_counters.lag_event_count;

    if (s_last_gain_write_us > 0) {
        int64_t dt = now - s_last_gain_write_us;
        if (dt >= 0 && dt <= 200000) ++s_hw_counters.near_gain_event_count;
    }
    if (s_last_phy_write_us > 0) {
        int64_t dt = now - s_last_phy_write_us;
        if (dt >= 0 && dt <= 200000) ++s_hw_counters.near_phy_event_count;
    }
}

/* Poll sticky transport fault status without enabling any interrupts. Any
 * sticky fault becomes a lag event correlated against the last PHY write. */
static void poll_transport_faults(void)
{
    uint32_t flags = 0;
    bool tx_rempty = PARL_IO.int_raw.tx_fifo_rempty_int_raw != 0;

    if (tx_rempty) {
        ++s_hw_counters.parl_tx_rempty_count;
        PARL_IO.int_clr.tx_fifo_rempty_int_clr = 1;
        flags |= LAG_EVT_PARLIO_TX_REMPTY;
    }
    if (PARL_IO.int_raw.rx_fifo_wovf_int_raw) {
        ++s_hw_counters.parl_rx_wovf_count;
        PARL_IO.int_clr.rx_fifo_wovf_int_clr = 1;
        flags |= LAG_EVT_PARLIO_RX_WOVF;
    }
    if (PARL_IO.int_raw.tx_eof_int_raw) {
        ++s_hw_counters.parl_tx_eof_count;
        PARL_IO.int_clr.tx_eof_int_clr = 1;
        flags |= LAG_EVT_PARLIO_TX_EOF;
    }

    if (s_rx_dma_ch >= 0 && s_rx_dma_ch < 3) {
        uint32_t raw = AHB_DMA.in_intr[s_rx_dma_ch].raw.val & GDMA_IN_FAULT_MASK;
        if (raw) {
            ++s_hw_counters.gdma_in_fault_count;
            AHB_DMA.in_intr[s_rx_dma_ch].clr.val = raw;
            flags |= LAG_EVT_GDMA_IN_FAULT;
        }
    }
    if (s_tx_dma_ch >= 0 && s_tx_dma_ch < 3) {
        uint32_t raw = AHB_DMA.out_intr[s_tx_dma_ch].raw.val & GDMA_OUT_FAULT_MASK;
        if (raw) {
            ++s_hw_counters.gdma_out_fault_count;
            AHB_DMA.out_intr[s_tx_dma_ch].clr.val = raw;
            flags |= LAG_EVT_GDMA_OUT_FAULT;
        }
    }

    if (tx_rempty && BITSCRAMBLER.state[BITSCRAMBLER_DIR_TX].fifo_empty) {
        ++s_hw_counters.bs_fifo_empty_count;
    }
    if (BITSCRAMBLER.state[BITSCRAMBLER_DIR_TX].eof_overload) {
        ++s_hw_counters.bs_eof_overload_count;
        BITSCRAMBLER.state[BITSCRAMBLER_DIR_TX].val = 1u << 31;
        flags |= LAG_EVT_BS_EOF_OVERLOAD;
    }

    ++s_hw_counters.checks;
    record_transport_event(flags);
}

/* Menu text and timing are generated only by the AGC/control task. */
static void menu_draw_string(int row, int margin, const char *str)
{
    (void)margin;
    if (row < 0 || row >= (int)MENU_ROWS) return;
    for (unsigned y = 0; y < MENU_FONT_HEIGHT; ++y) {
        uint8_t *dst = s_menu_raster.text[row * MENU_FONT_HEIGHT + y];
        memset(dst, 20, MENU_TEXT_BYTES);
        for (unsigned ch = 0; ch < 31 && str[ch]; ++ch) {
            unsigned index = (str[ch] >= 32 && str[ch] <= 126) ? str[ch] - 32 : 0;
            uint8_t bits = s_font8x8[index][y];
            for (unsigned bit = 0; bit < 8; ++bit) {
                memset(dst + 32 + ch * 32 + bit * 4,
                       bits & (0x80u >> bit) ? 60 : 20, 4);
            }
        }
    }
}

static bool menu_append_segment(void *ctx, const uint8_t *data, unsigned length)
{
    (void)ctx;
    if (s_menu_node_count >= MENU_MAX_NODES || length > 4092 ||
        ((uintptr_t)data & 3) || (length & 3)) return false;
    dma_descriptor_t *node = &s_menu_nodes[s_menu_node_count++];
    memset(node, 0, sizeof(*node));
    node->dw0.size = length;
    node->dw0.length = length;
    node->dw0.owner = 1;
    node->buffer = (void *)data;
    node->next = &s_menu_nodes[s_menu_node_count];
    return true;
}

static void menu_render_menu(void);

static void menu_init_buffers(void)
{
    menu_raster_init(&s_menu_raster, s_video_std);
    s_menu_node_count = 0;
    ESP_ERROR_CHECK(menu_raster_emit(&s_menu_raster, s_video_std,
                                   menu_append_segment, NULL) ? ESP_OK : ESP_ERR_INVALID_SIZE);
    s_menu_nodes[s_menu_node_count - 1].next = s_menu_nodes;
    menu_render_menu();
    sync_dma_c2m(&s_menu_raster, sizeof(s_menu_raster));
    sync_dma_c2m(s_menu_nodes, s_menu_node_count * sizeof(*s_menu_nodes));
}

static void menu_render_menu(void)
{
    const fpv_channel_t *ch = rf_get_current_channel();
    char buf[40];

    snprintf(buf, sizeof(buf), "=== C5VRX-3 MENU (%s) ===",
             (s_video_std == VIDEO_STD_PAL) ? "PAL 625i" : "NTSC 525i");
    menu_draw_string(0, 16, buf);

    snprintf(buf, sizeof(buf), "%c [1] BAND:   %s",
             (s_menu_cursor == 0) ? '>' : ' ', rf_get_band_name(rf_get_current_band()));
    menu_draw_string(1, 16, buf);

    if (s_last_q_phase >= 40) {
        snprintf(buf, sizeof(buf), "%c [2] CH:     %s (%uM) [CFO:%+dk]",
                 (s_menu_cursor == 1) ? '>' : ' ', ch->name, ch->freq_mhz, s_cfo_khz);
    } else {
        snprintf(buf, sizeof(buf), "%c [2] CH:     %s (%u MHz)",
                 (s_menu_cursor == 1) ? '>' : ' ', ch->name, ch->freq_mhz);
    }
    menu_draw_string(2, 16, buf);

    snprintf(buf, sizeof(buf), "%c [3] GEAR:   %s",
             (s_menu_cursor == 2) ? '>' : ' ', s_current_bw40 ? "BW40 (COLOR)" : "BW20 (+3dB)");
    menu_draw_string(3, 16, buf);

    snprintf(buf, sizeof(buf), "%c [4] AFC:    %s",
             (s_menu_cursor == 3) ? '>' : ' ',
             (s_afc_mode == AFC_MODE_AUTO) ? "AUTO EXP (+/-1.5M)" :
             (s_afc_mode == AFC_MODE_HOLD) ? "HOLD (FROZEN)" : "OFF (0 kHz)");
    menu_draw_string(4, 16, buf);

    snprintf(buf, sizeof(buf), "%c [5] STD:    %s",
             (s_menu_cursor == 4) ? '>' : ' ',
             (s_video_std == VIDEO_STD_PAL) ? "PAL 625i (50Hz)" : "NTSC 525i (60Hz)");
    menu_draw_string(5, 16, buf);

    snprintf(buf, sizeof(buf), "%c [6] SAVE & EXIT",
             (s_menu_cursor == 5) ? '>' : ' ');
    menu_draw_string(6, 16, buf);

    sync_dma_c2m(s_menu_raster.text, sizeof(s_menu_raster.text));
}

static void quiet_tx_interrupts(void)
{
    AHB_DMA.out_intr[s_tx_dma_ch].ena.val = 0;
    AHB_DMA.out_intr[s_tx_dma_ch].clr.val = UINT32_MAX;
    PARL_IO.int_ena.val = 0;
}

static void start_flight_demodulator(void)
{
    ESP_ERROR_CHECK(bitscrambler_enable(s_flight_bs));
    ESP_ERROR_CHECK(bitscrambler_load_program(s_flight_bs,
        s_traj_demod_active ? s_fm_traj_program : s_fm_program));
    ESP_ERROR_CHECK(bitscrambler_reset(s_flight_bs));
    ESP_ERROR_CHECK(bitscrambler_start(s_flight_bs));
}

/* A/B demod switch (console 'T'): swaps the BitScrambler program on the
 * LIVE TX using the exact call sequence of the proven boot/menu paths
 * (disable -> enable -> load -> reset -> start). The PARLIO TX ring loop,
 * DMA descriptors and zero-EOF patch are untouched -- the only side effect
 * is the frames around the swap (raw ring bytes reach the DAC while the
 * bitscrambler is down). Refused while the menu owns the TX chain. */
static void demod_toggle_traj(void)
{
    if (s_menu_active) {
        printf("[DEMOD] close the menu first (menu owns the TX chain)\n");
        return;
    }
    s_traj_demod_active = !s_traj_demod_active;
    esp_err_t err = bitscrambler_disable(s_flight_bs);
    if (err == ESP_OK) err = bitscrambler_enable(s_flight_bs);
    if (err == ESP_OK) {
        err = bitscrambler_load_program(s_flight_bs,
            s_traj_demod_active ? s_fm_traj_program : s_fm_program);
    }
    if (err == ESP_OK) err = bitscrambler_reset(s_flight_bs);
    if (err == ESP_OK) err = bitscrambler_start(s_flight_bs);
    if (err != ESP_OK) {
        printf("[DEMOD] switch failed (%s); restoring proven fm.bsasm\n",
               esp_err_to_name(err));
        s_traj_demod_active = false;
        (void)bitscrambler_load_program(s_flight_bs, s_fm_program);
        (void)bitscrambler_reset(s_flight_bs);
        (void)bitscrambler_start(s_flight_bs);
        return;
    }
    printf("[DEMOD] %s active (A/B: same signal, compare DAC/goggle output)\n",
           s_traj_demod_active ? "TRAJECTORY V2 (fm_traj)" : "GOLDEN PHASE5 (fm)");
}

static void start_menu_tx(void)
{
    /* IDF owns the channel allocation and stop/reset lifecycle. While its TX
     * transaction queue is empty, start our SRAM scatter chain directly.
     * No driver-private structure access and no active descriptor rewiring. */
    ESP_ERROR_CHECK(parlio_tx_unit_enable(s_tx));
    quiet_tx_interrupts();
    parlio_ll_tx_enable_clock(&PARL_IO, false);
    parlio_ll_tx_reset_clock(&PARL_IO);
    parlio_ll_tx_reset_fifo(&PARL_IO);
    parlio_ll_tx_set_idle_data_value(&PARL_IO, DAC_IDLE_CODE);
    parlio_ll_tx_set_eof_condition(&PARL_IO, PARLIO_LL_TX_EOF_COND_DATA_LEN);
    parlio_ll_tx_set_trans_bit_len(&PARL_IO, 1);
    __asm__ __volatile__("fence rw, rw" ::: "memory");
    AHB_DMA.out_link_addr[s_tx_dma_ch].val = (uint32_t)s_menu_nodes;
    AHB_DMA.channel[s_tx_dma_ch].out.out_link.outlink_start_chn = 1;
    int64_t deadline = esp_timer_get_time() + 1000;
    while (!parlio_ll_tx_is_ready(&PARL_IO)) {
        ESP_ERROR_CHECK(esp_timer_get_time() < deadline ? ESP_OK : ESP_ERR_TIMEOUT);
    }
    parlio_ll_tx_start(&PARL_IO, true);
    parlio_ll_tx_enable_clock(&PARL_IO, true);
}

static void video_set_menu_mode(bool active)
{
    if (s_menu_active == active) return;
    if (active) {
        buzzer_event(BUZZER_EVENT_MENU_OPEN);
        buzzer_set_proximity(-1, 0); /* Mute foxhunt cadence while the menu is up */
    } else {
        buzzer_event(BUZZER_EVENT_MENU_CLOSE);
        /* AGC task resumes cadence updates on its next 50 ms tick */
    }
    ESP_ERROR_CHECK(parlio_tx_unit_disable(s_tx));
    ESP_ERROR_CHECK(bitscrambler_disable(s_flight_bs));
    if (active) {
        menu_init_buffers();
        start_menu_tx();
    } else {
        /* Restart the producer at ring zero; delaying an already running RX
         * would leave TX's offset arbitrary. Load Phase5 before timing RX. */
        start_flight_demodulator();
        ESP_ERROR_CHECK(parlio_rx_unit_disable(s_rx));
        ESP_ERROR_CHECK(parlio_rx_unit_enable(s_rx, false));
        ESP_ERROR_CHECK(parlio_tx_unit_enable(s_tx));
        quiet_tx_interrupts();
        ESP_ERROR_CHECK(start_rx());
        AHB_DMA.in_intr[s_rx_dma_ch].ena.val = 0;
        PARL_IO.rx_genrl_cfg.rx_eof_gen_sel = 1;
        esp_rom_delay_us(8192ULL * 1000000ULL / IQ_RATE_HZ);
        ESP_ERROR_CHECK(start_tx());
        quiet_tx_interrupts();
        patch_descriptors_clear_eof(s_rx_dma_ch, true);
        patch_descriptors_clear_eof(s_tx_dma_ch, false);
    }
    s_menu_timeout_ticks = 0;
    s_menu_active = active;
}

static void menu_toggle_standard(void)
{
    if (s_menu_active) ESP_ERROR_CHECK(parlio_tx_unit_disable(s_tx));
    s_video_std = s_video_std == VIDEO_STD_PAL ? VIDEO_STD_NTSC : VIDEO_STD_PAL;
    if (s_menu_active) {
        menu_init_buffers();
        start_menu_tx();
    }
}

static void init_boot_button(void)
{
    const gpio_config_t cfg = {
        .pin_bit_mask = 1ULL << BOOT_BTN_GPIO,
        .mode = GPIO_MODE_INPUT,
        .pull_up_en = GPIO_PULLUP_ENABLE,
        .pull_down_en = GPIO_PULLDOWN_DISABLE,
        .intr_type = GPIO_INTR_DISABLE,
    };
    gpio_config(&cfg);
}

static void handle_button_short_click(void)
{
    buzzer_event(BUZZER_EVENT_TICK);
    if (s_menu_active) {
        s_menu_cursor = (s_menu_cursor + 1) % 6;
        menu_render_menu();
        s_menu_timeout_ticks = 0;
        printf("[BTN: SHORT] Menu cursor -> %d\n", s_menu_cursor);
    } else {
        rf_cycle_channel_in_band();
        s_cfo_khz = 0;
        s_agc_state = AGC_STATE_SEARCH;
        video_standard_detector_reset();
        const fpv_channel_t *ch = rf_get_current_channel();
        printf("[BTN: SHORT] Channel switched to %s (%u MHz) in %s\n",
               ch->name, ch->freq_mhz, rf_get_band_name(rf_get_current_band()));
    }
}

static void handle_button_long_click(void)
{
    if (!s_menu_active) {
        if (!s_menu_boot_btn_enabled) {
            printf("[BTN: LONG] Menu menu via BOOT button is DISABLED (Safe Flight Mode)\n");
            return;
        }
        s_menu_cursor = 0;
        s_menu_timeout_ticks = 0;
        video_set_menu_mode(true);
        printf("[BTN: LONG] Menu Opened!\n");
    } else {
        switch (s_menu_cursor) {
        case 0: /* BAND */
            rf_cycle_band();
            s_cfo_khz = 0;
            s_agc_state = AGC_STATE_SEARCH;
            video_standard_detector_reset();
            buzzer_event(BUZZER_EVENT_BAND);
            printf("[MENU: BAND] Switched to %s\n", rf_get_band_name(rf_get_current_band()));
            break;
        case 1: /* CHANNEL */
            rf_cycle_channel_in_band();
            s_cfo_khz = 0;
            s_agc_state = AGC_STATE_SEARCH;
            video_standard_detector_reset();
            buzzer_event(BUZZER_EVENT_TICK);
            printf("[MENU: CHANNEL] Switched to %s (%u MHz)\n",
                   rf_get_current_channel()->name, rf_get_current_channel()->freq_mhz);
            break;
        case 2: /* GEAR (BW40 / BW20) */
            s_current_bw40 = !s_current_bw40;
            apply_rf_bandwidth(s_current_bw40);
            printf("[MENU: GEAR] Bandwidth set to %s\n", s_current_bw40 ? "BW40" : "BW20");
            break;
        case 3: /* AFC MODE */
            if (s_afc_mode == AFC_MODE_AUTO) {
                s_afc_mode = AFC_MODE_HOLD;
            } else if (s_afc_mode == AFC_MODE_HOLD) {
                s_afc_mode = AFC_MODE_OFF;
                apply_frequency_offset_khz_tracked(0);
            } else {
                s_afc_mode = AFC_MODE_AUTO;
            }
            printf("[MENU: AFC] Mode -> %d\n", s_afc_mode);
            break;
        case 4: /* VIDEO STANDARD (NTSC / PAL) */
            menu_toggle_standard();
            printf("[MENU: STD] Switched standard -> %s\n", (s_video_std == VIDEO_STD_PAL) ? "PAL 625i (50Hz)" : "NTSC 525i (60Hz)");
            break;
        case 5: /* SAVE & EXIT */
            video_set_menu_mode(false);
            printf("[BTN: LONG] Menu Closed -> Live Video!\n");
            return;
        default:
            break;
        }
        menu_render_menu();
        s_menu_timeout_ticks = 0;
    }
}

/* Proximity cadence for a calibrated carrier level -- the settled OUI-SPY
 * foxhunt mapping, shared by the post-lock foxhunt and the pre-lock
 * detection cadence so the sound is continuous across the lock handoff.
 * Cadence AND pitch track the level: long range (few dB) = slow low beeps,
 * closing in = faster and higher, >= 40 dB (right on top of it) = a steady
 * high tone. One buzzer_set_proximity call (statics only, cheap). */
static void buzzer_proximity_for_level(float level_db)
{
    if (level_db >= 40.0f) {
        buzzer_set_proximity(0, 3200);
    } else {
        float lv = (level_db < 4.0f) ? 4.0f : level_db;
        int interval = 1200 - (int)((lv - 4.0f) * 30.0f); /* 4dB->1200ms, 40dB->120ms */
        if (interval < 120) interval = 120;
        int freq = 1600 + (int)(lv * 40.0f);              /* 4dB->1760Hz, 40dB->3200Hz */
        buzzer_set_proximity(interval, freq);
    }
}

static void analog_agc_task(void *arg)
{
    (void)arg;
    int settle_ticks = 0;
    int drift_counter = 0;
    int lost_counter = 0;
    int deep_fade_ticks = 0;
    int strong_signal_ticks = 0;
    int afc_ticks = 0;
    int telemetry_ticks = 0;


    int scan_confirm = -1;   /* ticks since scanner stopped on a candidate; -1 = inactive */
    int unlock_ticks = 0;
    int sync_age_ticks = 40; /* semantic-sync staleness (50 ms ticks); start stale */
    int menu_refresh_ticks = 0;
    uint8_t target_gain = 52u;
    /* Upstream range v2: 20 Hz supervisory controller owns gain while
     * ANALOG_AGC_ACTIVE. Trials + rollback + adaptive backoff live in
     * range_control.h; this instance is stack-local, reset whenever the
     * receive generation changes or the physical gain moves under it
     * (manual +/- keys, channel changes). */
    range_control_t range_controller;
    range_control_reset(&range_controller, s_current_gain);
    uint32_t receive_generation = s_receive_generation;

    /* ARC boot recovery (upstream "BOOT recovery selects ARC", PR #52):
     * the ARC receive chain is the production RF layer -- fixed BW40 /
     * AFC-off operation, gain at the vendor survival index (first entry
     * of the highest RF stage: maximum front-end sensitivity without
     * blindly maximizing BB/fine gain), controller synced to the table
     * captured during rf_start. This REPLACES the old G62 SEARCH park
     * with the stage-aware survival gain: rf_set_channel recaptures the
     * vendor table and bumps the ARC generation on every retune (incl.
     * scanner hops), so the ACTIVE path below re-parks to survival on
     * every hop. The classic state machine keeps its G62 SEARCH case for
     * SHADOW dry-run mode only. */
    s_bw_gear_mode = BW_GEAR_BW40;
    s_current_bw40 = true;
    apply_rf_bandwidth(true);
    s_afc_mode = AFC_MODE_OFF;
    if (rf_get_frequency_offset_khz() != 0) apply_frequency_offset_khz_tracked(0);
    apply_rx_gain_tracked(rf_get_arc_survival_gain());
    arc_controller_t arc_controller;
    arc_controller_reset(&arc_controller, rf_get_arc_gain_table(), s_current_gain);
    uint32_t seen_arc_generation = rf_get_arc_generation();

    int btn_ticks = 0;
    bool btn_long_fired = false;
    bool was_locked = false;

    int boot_grace_ticks = 20; /* 1.0s boot grace period (20 * 50ms): ignore reset/flash glitches */

    for (;;) {
        vTaskDelay(pdMS_TO_TICKS(50)); /* 20 Hz evaluation (every 50 ms) */

        /* Poll sticky transport fault status (f30297b): PARLIO TX starvation,
         * RX overflow, TX EOF, GDMA descriptor/FIFO faults and BitScrambler
         * EOF overload all become lag events correlated against the last
         * RF/PHY write. No interrupts are enabled. */
        poll_transport_faults();

        int command;
        for (unsigned commands = 0; commands < 16 &&
             xQueueReceive(s_menu_commands, &command, 0) == pdTRUE; ++commands) {
            if (command == 'o') video_set_menu_mode(!s_menu_active);
            else if (command == 'v' || command == 'V') menu_toggle_standard();
            else if (command == 'O') s_menu_boot_btn_enabled = !s_menu_boot_btn_enabled;
            else if (s_menu_active && (command == ' ' || command == 'n' || command == '\t'))
                handle_button_short_click();
            else if (s_menu_active) handle_button_long_click();
        }

        /* 1. BOOT Button Sampling & Debounce (GPIO 28, active LOW) */
        if (boot_grace_ticks > 0) {
            boot_grace_ticks--;
            btn_ticks = 0;
            btn_long_fired = false;
        } else {
            int btn_level = gpio_get_level(BOOT_BTN_GPIO);
            if (btn_level == 0) {
                btn_ticks++;
                if (btn_ticks >= 12 && !btn_long_fired) { /* 600 ms long press */
                    btn_long_fired = true;
                    handle_button_long_click();
                }
            } else {
                if (btn_ticks > 0) {
                    if (!btn_long_fired && btn_ticks >= 2) { /* 100 - 550 ms short click (>= 2 samples) */
                        handle_button_short_click();
                    }
                    btn_ticks = 0;
                    btn_long_fired = false;
                }
            }
        }

        /* 2. Menu Inactivity Timeout (12.0s auto-exit).
         * Zero console I/O or fflush calls inside this loop to guarantee
         * non-blocking execution regardless of USB host connection state!
         * a3ca2a9 (range v2 port): the receive controller KEEPS RUNNING
         * while the menu raster is displayed -- the menu has its own TX DMA
         * chain and PARLIO RX keeps filling the raw IQ ring, so gain and
         * signal state stay live instead of freezing for up to 12 s.
         * OUI-SPY behavior preserved on top: scanner hops, lock/buzzer
         * cadence and the LED stay frozen while the menu is up (gated
         * below) and the periodic [AGC:...] telemetry stays suppressed. */
        bool menu_active_now = s_menu_active;
        if (menu_active_now) {
            s_menu_timeout_ticks++;
            if (s_menu_timeout_ticks >= 240) { /* 12.0s inactivity auto-exit */
                video_set_menu_mode(false);
                printf("[MENU] Inactivity timeout (12s) -> Live Video\n");
                menu_active_now = false;
            }
        }

        /* Read a completed RX descriptor. A whole finished descriptor gives
         * 102.3 us of Q4/I4 rather than the old 6.4 us peek: the semantic
         * sync scorer needs whole video lines and the winding observer needs
         * the true 20 MS/s endpoint parity. The snapshot lives on this task's
         * stack -- .bss cannot spare 4 KiB of HP SRAM. Sampling s_raw_ring[0]
         * directly can race GDMA and create impossible mixed-window metrics. */
        uint8_t *sample_src = get_completed_rx_sample_window(CONTROL_SAMPLE_BYTES);
        size_t ring_offset =
            (sample_src >= s_raw_ring && sample_src < s_raw_ring + sizeof(s_raw_ring)) ?
            (size_t)(sample_src - s_raw_ring) : 0u;
        sync_dma_m2c((void *)sample_src, CONTROL_SAMPLE_BYTES);
        uint8_t sample_buf[CONTROL_SAMPLE_BYTES];
        memcpy(sample_buf, sample_src, sizeof(sample_buf));
        control_metrics_t metrics =
            analyze_control_window(sample_buf, sizeof(sample_buf), ring_offset);

        int n_clip = metrics.n_clip;
        int n_origin = metrics.n_origin;
        int n_coherent = metrics.n_coherent;
        int sum_cross = metrics.sum_cross;
        int sum_dot = metrics.sum_dot;
        int p_median = metrics.p_median;
        int q_phase = metrics.q_phase;
        int clip_permille = metrics.clip_permille;
        int origin_permille = metrics.origin_permille;
        int winding_permille = metrics.winding_permille;

        s_last_p_median = p_median;
        s_last_q_phase = q_phase;
        s_last_n_clip = n_clip;
        s_last_n_origin = n_origin;
        s_last_winding_permille = winding_permille;
        s_last_strong_winding_permille = metrics.strong_winding_permille;
        s_last_dc_i_x100 = metrics.dc_i_x100;
        s_last_dc_q_x100 = metrics.dc_q_x100;
        s_last_iq_skew_permille = metrics.iq_skew_permille;
        s_last_iq_cross_permille = metrics.iq_cross_permille;

        /* Semantic CVBS sync scorer (range v2): quality of real H-sync
         * structure in the demodulated waveform, 0..100. >=70 requires a
         * physically plausible repeated line period this window. Skipped
         * while settle_ticks holds: post-write windows are corrupt. */
        int sync_quality = 0;
        bool fresh_sync = false;
        if (settle_ticks == 0) {
            sync_quality = video_semantic_observe(sample_buf, sizeof(sample_buf),
                                                  ring_offset);
            fresh_sync = sync_quality >= 70;
        }
        if (fresh_sync) sync_age_ticks = 0;
        else if (sync_age_ticks < 100) ++sync_age_ticks;
        s_last_sync_age_ticks = sync_age_ticks;

        /* While the menu raster runs, refresh its text at 4 Hz so gain and
         * signal rows reflect the live controller instead of freezing. */
        if (menu_active_now) {
            if (++menu_refresh_ticks >= 5) {
                menu_refresh_ticks = 0;
                menu_render_menu();
            }
        } else {
            menu_refresh_ticks = 0;
        }

        /* Issue #28 classifier (f30297b): if raw carrier coherence collapses
         * within 200 ms of a new gain state, count the transition once. This
         * is evidence for an RF/PHY transient, not proof of a DMA stall. */
        if (s_gain_transition_count != s_last_gain_drop_transition &&
            s_last_gain_write_us > 0) {
            int64_t gain_age = esp_timer_get_time() - s_last_gain_write_us;
            if (gain_age >= 0 && gain_age <= 200000 &&
                q_phase < 25 && p_median < 12) {
                ++s_hw_counters.gain_quality_drop_count;
                s_last_gain_drop_transition = s_gain_transition_count;
            }
        }

        /* Carrier-power metering & discrimination (adopted from
         * KonradIT/C5VRX-buzzer, measured constants from hardware 2026-09-18).
         * FM demodulation removes amplitude, so distance comes from pre-demod
         * carrier power calibrated against the forced gain index:
         *   level_db = (GAIN_MAX - gain) * DB_PER_INDEX + 10 log10(p / NOISE)
         * A 25 mW VTX reads ~14 dB at 1 m and ~30+ dB touching the board. */
        float pow_mean = (float)metrics.sum_p * (1.0f / (float)CONTROL_SAMPLE_BYTES);
        float pow_var = (float)metrics.sum_p2 * (1.0f / (float)CONTROL_SAMPLE_BYTES) -
                        pow_mean * pow_mean;
        if (pow_var < 0.0f) pow_var = 0.0f;

        /* Wi-Fi burst rejection: a packet raises one window; take the minimum
         * mean power over the last 4 ticks (~200 ms). A continuous FM carrier
         * keeps the minima up, bursts do not. */
        static float pow_hist[4];
        static unsigned pow_hist_pos;
        pow_hist[pow_hist_pos] = pow_mean;
        pow_hist_pos = (pow_hist_pos + 1u) & 3u;
        float pow_min = pow_hist[0];
        for (unsigned k = 1; k < 4; k++) {
            if (pow_hist[k] < pow_min) pow_min = pow_hist[k];
        }

        float level_db = 0.0f;
        if (pow_min >= 3.0f) { /* SQUELCH: nothing above the noise below this */
            level_db = (62.0f - (float)s_current_gain) +
                       10.0f * log10f(pow_min / 2.0f); /* NOISE_POWER = 2.0 */
            if (level_db < 0.0f) level_db = 0.0f;
            if (level_db > 99.0f) level_db = 99.0f;
        }
        s_last_level_dbc = (int)(level_db * 10.0f);

        /* Discrimination:
         * 1. Envelope: FM is constant-envelope, var/mean^2 << 1; Gaussian
         *    noise sits near 1.0. Only judged when strong enough to tell.
         * 2. Modulation: video FM swings the phase step (cross) across the
         *    line; an unmodulated/CW carrier holds it constant (var ~ 0). */
        /* Discrimination, vote-smoothed over the last 8 ticks (~400 ms).
         * A single 6.4 us window lands on sync/blanking (near-constant FM
         * deviation) or a noise burst often enough that instantaneous tests
         * flicker and re-trigger the lock chirp. Vote instead:
         * 1. Envelope: noise-like only if >=5 of 8 ticks look Gaussian
         *    (weak channels stay untested; FM is constant-envelope).
         * 2. Modulation: present if >=3 of 8 ticks show FM phase swing
         *    (rejects unmodulated/CW carriers). */
        bool strong_enough = pow_min >= 6.0f;
        bool env_bad_now = strong_enough && pow_mean >= 1.0f &&
                           (pow_var / (pow_mean * pow_mean)) >= 0.7f;
        float cross_mean = (n_coherent > 0) ? (float)sum_cross / n_coherent : 0.0f;
        float cross_var = (n_coherent > 0) ?
            (float)metrics.sum_cross2 / n_coherent - cross_mean * cross_mean : 0.0f;
        bool mod_good_now = (n_coherent >= 30) && (cross_var > 25.0f);
        static unsigned env_bad_vote, mod_good_vote;
        env_bad_vote = ((env_bad_vote << 1) | (env_bad_now ? 1u : 0u)) & 0xffu;
        mod_good_vote = ((mod_good_vote << 1) | (mod_good_now ? 1u : 0u)) & 0xffu;
        bool envelope_ok = __builtin_popcount(env_bad_vote) < 5;
        bool modulation_ok = __builtin_popcount(mod_good_vote) >= 3;
        bool carrier_ok = envelope_ok && modulation_ok;

        /* Instant peak detector (audible blips + fast-lock authority).
         * "Clearly above the noise" by every trusted family we have, in the
         * SAME tick (no vote accumulation, so it can fire on a fresh
         * channel):
         *   - p_median >= 12:  the skip-dead/SEARCH power family trusts
         *     p_median >= 8 as "real carrier energy"; thermal noise sits at
         *     2-4 (NOISE_POWER = 2.0 in the level meter), so 12 is >=3x the
         *     noise median with margin.
         *   - pow_mean >= 6.0f: the strong_enough squelch floor (noise mean
         *     ~2); requires the WHOLE 102 us window to ride above noise.
         *   - !env_bad_now: this window's envelope is not Gaussian, which
         *     rejects Wi-Fi burst spikes (OFDM has high PAPR) and static.
         * Static/burst can pass any ONE of these transiently; passing all
         * three in one window is a real peak. NEVER fires on static. */
        const bool peak_now = (p_median >= 12) && (pow_mean >= 6.0f) && !env_bad_now;

        /* Carrier Frequency Offset (CFO) Calculation:
         * Delta_f = (Cross / Dot) * (fs / 2pi) = (Cross / Dot) * 6366 kHz. */
        if (n_coherent >= 30 && sum_dot > 0) {
            int instant_cfo = (int)(((int64_t)sum_cross * 6366LL) / sum_dot);
            if (instant_cfo > 2000)  instant_cfo = 2000;
            if (instant_cfo < -2000) instant_cfo = -2000;
            s_cfo_khz = (s_cfo_khz * 7 + instant_cfo) / 8;
        }

        /* Channel scanner (console 'g'): flat 200 ms dwell per channel (50 ms
         * quick dwell on skip-dead parked channels), hop through all 48 FPV
         * channels until a coherent FM carrier appears, then stop and let
         * the AGC lock it. Detection uses the same coherence/power metrics
         * as the lock detector; the classic SEARCH state parks gain at G62
         * while hopping (pre-port behavior -- 6efe2ed SEARCH case).
         * Every hop emits one [SWEEP] line so the dashboard can draw a live
         * per-channel spectrum view.
         * Dead-channel skip (console 'k', web toggle) is authoritative: ON
         * -> channels with miss >= 3 on non-re-check sweeps take the 50 ms
         * quick dwell; every 4th sweep re-checks them at full dwell. OFF ->
         * flat 200 ms everywhere.
         * s_scan_ticks is reset on every scan start/stop transition so a
         * resumed scan always begins a fresh dwell (real fix from the
         * two-tier experiment; pre-port this staleness was harmless at
         * dwell 4 only when resuming mid-dwell... kept as hardening).
         * OUI-SPY: hops stay frozen while the menu is open. */
        /* Fast two-tier dwell (done right this time): with the range
         * controller benched and the classic SEARCH park holding G62
         * through every hop, each 50 ms window judges its channel at max
         * gain -- the original two-tier (4d5da73) failed only because the
         * walked-down controller gain made quick verdicts deaf. Every
         * channel gets the 50 ms BASE tier; a dwell that shows real energy
         * extends to 200 ms on that channel only (monotonic latch), so
         * marginal signals keep the integration the old flat dwell had,
         * and the c73f627 per-tick fast declare can still fire mid-dwell.
         * Dead-air sweep: 48 x 50 ms = 2.4 s. Skip-dead stays authoritative:
         * ON -> parked channels (miss >= 3, non-re-check sweeps) take the
         * 50 ms quick tier and are never extended; every 4th sweep re-checks
         * through the normal base+extension path. OFF -> the quick tier
         * never runs.
         * Every hop still prints exactly one [SWEEP] line (flask spectrum);
         * s_scan_ticks/s_scan_dwell_extended reset on every scan start/stop
         * transition; hops stay frozen while the menu is open. */
        bool just_hopped = false;

        /* Grabber lock input (video reality): the preview/composite grabber
         * (preview.c h_locked) syncs on CVBS structure independently of the
         * legacy envelope/vote detector -- during extended dwells it can hold
         * a real, error-free frame lock while legacy still says no, which is
         * how the dashboard showed video with no receiver lock. Fold it into
         * the receiver lock below. h_locked updates once per grab attempt
         * (~15 fps, up to ~130 ms of staleness after a channel change), so:
         *   - scanner park: only from the 3rd tick on-channel (>=150 ms);
         *   - lock declare: same on-channel minimum while scanning, never on
         *     a hop tick, and immediately when parked (no hop staleness).
         * Drop side needs no new logic: the combined release debounce
         * (10 ticks of BOTH absent) already covers brief grabber drops.
         * Read-only use of the existing API, once per AGC tick. */
        bool grabber_raw = false;
        preview_get_stats(NULL, NULL, NULL, NULL, &grabber_raw, NULL);

        if (!menu_active_now && s_scan_mode) {
            size_t scan_idx = rf_get_channel_index();
            const bool quick = s_skip_dead &&
                s_chan_miss[scan_idx] >= SKIP_DEAD_MISS_THRESHOLD &&
                (s_sweep_count % 4u) != 0u;
            unsigned dwell = quick ? SKIP_DWELL_TICKS : BASE_DWELL_TICKS;
            if (s_scan_dwell_extended) dwell = CANDIDATE_DWELL_TICKS;
            const int tick_on_channel = s_scan_ticks; /* completed ticks before this one */
            if (++s_scan_ticks >= (int)dwell) {
                /* End of the current tier. Extend a base-tier dwell once, at
                 * its end, if the channel shows real energy: median power at
                 * the proven SEARCH sensitivity (p_median >= 8; thermal noise
                 * sits at 2-4), or the stricter burst-qualified c73f627
                 * peak_now predicate. (peak_now implies p_median >= 12, so
                 * the OR is redundant today -- it documents that either
                 * predicate alone suffices and stays correct if the two ever
                 * diverge.) */
                if (!s_scan_dwell_extended && !quick && dwell == BASE_DWELL_TICKS &&
                    ((p_median >= 8) || peak_now)) {
                    s_scan_dwell_extended = true; /* dwell grows to 4; tick count continues */
                } else {
                    s_scan_dwell_extended = false;
                    s_scan_ticks = 0;
                    if ((q_phase >= 40 && carrier_ok) ||
                        (grabber_raw && tick_on_channel >= 2)) {
                        /* Legacy-candidate OR grabber-locked park. The
                         * tick_on_channel >= 2 gate (>=3 ticks on-channel)
                         * keeps the grabber's ~130 ms post-hop staleness
                         * from parking on the previous channel's lock. */
                        s_chan_miss[scan_idx] = 0; /* life on this channel */
                        s_scan_mode = false;
                        s_scan_ticks = 0; /* next scan session starts on a fresh dwell */
                        s_scan_dwell_extended = false;
                        scan_confirm = 0; /* watchdog: full lock must confirm within 3 s */
                        const fpv_channel_t *ch = rf_get_current_channel();
                        printf("[SCAN] Carrier candidate: %s (%u MHz) in %s (P_med=%d, Q_phase=%d%%)\n",
                               ch->name, ch->freq_mhz, rf_get_band_name(rf_get_current_band()),
                               p_median, q_phase);
                    } else {
                        const fpv_channel_t *ch = rf_get_current_channel();
                        printf("[SWEEP] %s P=%d Q=%d\n", ch->name, p_median, q_phase);
                        if (s_chan_miss[scan_idx] < 255u) ++s_chan_miss[scan_idx];
                        rf_cycle_channel(); /* wraps through all 48 channels */
                        just_hopped = true; /* suppress blips this tick */
                        if (rf_get_channel_index() < scan_idx) ++s_sweep_count;
                        s_agc_state = AGC_STATE_SEARCH;
                        s_cfo_khz = 0;
                    }
                }
            }
        }

        /* Grabber contribution to the receiver lock, staleness-gated (see
         * above): from the 3rd tick on-channel while scanning, never on a
         * hop tick, immediately when parked. */
        const bool grabber_locked = grabber_raw && !just_hopped &&
            (!s_scan_mode || s_scan_ticks >= 3);

        if (s_agc_mode == ANALOG_AGC_MANUAL) {
            target_gain = s_current_gain;
            s_shadow_gain = s_current_gain;
            goto apply_target;
        }

        /* Benched range v2 controller (hardware verdict 2026-09): runs
         * OBSERVATION-ONLY -- optimize_allowed = false, so it keeps scoring
         * for the diagnostics dump but can never write gain. The gain
         * authority in ACTIVE mode is the ARC receive chain below (upstream
         * PR #52); the classic state machine under it remains for SHADOW
         * dry-run, keeping its G62 SEARCH case. The s_legacy_lock_confirmed
         * mirror is unaffected: it still gates the gearbox/AFC freezes in
         * control_tail (ARC covers gain/BW/offset writes by design -- fixed
         * BW40/AFC-off, zero writes under clean LOCK -- but never touches
         * the BW/offset movers, so our freeze gates stay). */
        if (s_agc_mode == ANALOG_AGC_ACTIVE) {
            if (receive_generation != s_receive_generation ||
                range_controller.gain != s_current_gain) {
                receive_generation = s_receive_generation;
                range_control_reset(&range_controller, s_current_gain);
            }
            (void)range_control_tick(&range_controller, fresh_sync,
                sync_quality, p_median, q_phase, clip_permille,
                origin_permille, winding_permille,
                false /* benched: observation-only, never optimize */);
            if (menu_active_now) {
                /* a3ca2a9: keep the observer (and gain state) live while the
                 * menu raster runs; gain decisions stay paused, matching the
                 * menu-era freeze. ARC resumes on exit (retunes made in the
                 * menu bump the generation and are picked up then). */
                settle_ticks = 0;
                goto control_tail;
            }
            /* Menu closed: the ARC receive chain owns gain in ACTIVE mode.
             * rf_set_channel() recaptures the vendor gain table after every
             * retune and bumps the ARC generation (the controller is the
             * sole retune owner), so no ARC state can retain a tuple from
             * an older channel -- and every scanner hop re-parks to the
             * survival gain, replacing the old G62 SEARCH park. */
            const uint32_t arc_generation = rf_get_arc_generation();
            if (seen_arc_generation != arc_generation) {
                seen_arc_generation = arc_generation;
                apply_rx_gain_tracked(rf_get_arc_survival_gain());
                arc_controller_reset(&arc_controller, rf_get_arc_gain_table(),
                                     s_current_gain);
            }
            /* Our settled lock semantics feed ARC's lock evidence: the
             * unified receiver lock (legacy fast/vote declare + grabber)
             * counts as sync so ARC never walks gain down under a lock our
             * detector trusts. All other observations are the same per-tick
             * metrics the benched controller and lock detector use. */
            const arc_observation_t arc_obs = {
                .sync = fresh_sync || was_locked,
                .sync_quality = (was_locked && sync_quality < 70) ? 70 : sync_quality,
                .p_median = p_median,
                .q_phase = q_phase,
                .clip_permille = clip_permille,
                .origin_permille = origin_permille,
                .winding_permille = winding_permille,
            };
            target_gain = arc_controller_tick(&arc_controller, &arc_obs);
            s_shadow_gain = target_gain;
            s_agc_state = arc_controller.state == ARC_LOCK ?
                          AGC_STATE_TRACK : AGC_STATE_LEARN;
            if (target_gain != s_current_gain) {
                uint8_t old_g = s_current_gain;
                apply_rx_gain_tracked(target_gain);
                printf("[AGC:GAIN] %u -> %u (P_med=%d, Q_phase=%d%%, Clip=%d, State=%s)\n",
                       old_g, s_current_gain, p_median, q_phase, n_clip,
                       arc_controller.state == ARC_LOCK ? "TRACK" : "LEARN");
            }
            /* ARC owns its settling and never changes BW/AFC in flight. */
            settle_ticks = 0;
            goto control_tail;
        }

        /* Settle delay after gain change (classic path: SHADOW dry-run) */
        if (settle_ticks > 0) {
            settle_ticks--;
            goto update_telemetry;
        }

        /* 2. Fast Overload Safety Rem:
         * Triggers if clipping occurs (>=1.6% of samples) AND median power is elevated. */
        if (clip_permille >= 16 && p_median > 18) {
            int drop = (clip_permille >= 63) ? 6 : 4;
            target_gain = (target_gain > drop + 2) ? (target_gain - drop) : 2;
            s_agc_state = AGC_STATE_LEARN;
            settle_ticks = 2; /* 100 ms settle */
            drift_counter = 0;
            lost_counter = 0;
            goto apply_target;
        }

        /* 3. State Machine */
        switch (s_agc_state) {
        case AGC_STATE_SEARCH:
            /* Sensitive carrier detection: coherent phase, power, or departure from origin */
            if (q_phase >= 25 || p_median >= 8 || origin_permille < 700) {
                s_agc_state = AGC_STATE_LEARN;
                drift_counter = 0;
                lost_counter = 0;
            } else {
                /* No verified carrier: stay at maximum receive gain. This also
                 * allows the BW gearbox to enter BW20 while searching, so a
                 * carrier that is only recoverable in the narrow mode can be acquired. */
                target_gain = 62u;
            }
            break;

        case AGC_STATE_LEARN:
            /* Signal too hot or clipping: step gain down */
            if (p_median > 34 || clip_permille >= 23) {
                int drop = (clip_permille >= 47) ? 6 : 4;
                target_gain = (target_gain > drop + 2) ? (target_gain - drop) : 2;
                settle_ticks = 6; /* 300 ms settle between adjustments */
            }
            /* Signal weak or picture degrading: actively step gain UP towards 62 */
            else if ((p_median < 16 || q_phase < 55) && target_gain < 62u && clip_permille <= 8) {
                int step = (q_phase < 40 || p_median < 12) ? 4 : 2;
                if ((int)target_gain + step <= 62) {
                    target_gain += step;
                } else {
                    target_gain = 62u;
                }
                settle_ticks = 6; /* 300 ms settle between adjustments */
            }
            /* Optimal target zone converged */
            else {
                /* TRACK requires an actually coherent FM carrier */
                if (clip_permille <= 12 && q_phase >= 55) {
                    s_agc_state = AGC_STATE_TRACK;
                    drift_counter = 0;
                    lost_counter = 0;
                }
            }
            break;

        case AGC_STATE_TRACK:
            /* Check for total carrier loss: 500 ms persistent loss */
            if (q_phase < 25 && p_median < 12) {
                lost_counter++;
                if (lost_counter >= 10) { /* ~500 ms persistent loss */
                    s_agc_state = AGC_STATE_SEARCH;
                    lost_counter = 0;
                    break;
                }
            } else {
                lost_counter = 0;
            }

            /* Rock-solid hysteresis deadband:
             * 1. Needs boost: signal has genuinely degraded persistently
             *    (Q_phase < 45% or P_median < 14) while not at maximum gain.
             * 2. Needs cut: signal is hard clipping (P_median > 36 or >=3.1% clipped). */
            bool needs_gain_boost = (q_phase < 45 || p_median < 14) && (target_gain < 62u) && (clip_permille <= 8);
            bool needs_gain_cut   = (p_median > 36) || (clip_permille >= 31);

            if (needs_gain_boost || needs_gain_cut) {
                drift_counter++;
                if (drift_counter >= 15) { /* Must persist for 750 ms continuously! */
                    s_agc_state = AGC_STATE_LEARN;
                    drift_counter = 0;
                }
            } else {
                drift_counter = 0;
                /* Inside wide deadband: 100% frozen, ZERO register writes */
            }
            break;
        }

apply_target:
        s_shadow_gain = target_gain;
        if (s_agc_mode == ANALOG_AGC_ACTIVE) {
            if (target_gain != s_current_gain) {
                uint8_t old_g = s_current_gain;
                s_current_gain = target_gain;
                apply_rx_gain_tracked(s_current_gain); /* tracked wrapper also refreshes shadow gain */
                settle_ticks = GAIN_SETTLE_TICKS; /* 500 ms settle delay after RF gain write to prevent rapid staircasing */
                printf("[AGC:GAIN] %u -> %u (P_med=%d, Q_phase=%d%%, Clip=%d, State=%s)\n",
                       old_g, s_current_gain, p_median, q_phase, n_clip,
                       (s_agc_state == AGC_STATE_TRACK) ? "TRACK" :
                       (s_agc_state == AGC_STATE_LEARN) ? "LEARN" : "SRCH");
            }
        }

control_tail:
        /* 4. Dynamic Bandwidth Gearbox (BW40 High Gear <-> BW20 Long-Range Survival)
         * OUI-SPY: our settled AUTO gearbox survives the port (deep-fade BW20
         * survival mode); upstream's range profile instead forbids BW writes
         * in TRACK. User can force BW40/BW20 with console 'b'.
         * Locked = frozen RF: while the legacy lock holds, the AUTO gearbox
         * evaluates nothing and writes nothing. deep_fade/strong_signal
         * counters keep their values (frozen), so a pending shift is
         * re-evaluated promptly at unlock instead of bursting or being
         * discarded. Forced-mode convergence below is manual-origin and
         * stays writable. */
        if (s_bw_gear_mode == BW_GEAR_AUTO) {
            if (!s_legacy_lock_confirmed) {
            if (s_current_bw40) {
                /* In BW40: downshift to BW20 if entering deep fade / severe starvation */
                if (s_current_gain >= 56u && (q_phase < 55 || p_median < 16)) {
                    deep_fade_ticks++;
                    if (deep_fade_ticks >= 4) { /* Persisted for 200 ms */
                        s_current_bw40 = false;
                        apply_rf_bandwidth(false); /* DOWNSHIFT to BW20 (+3 dB boost!) */
                        printf("[GEARBOX] DOWNSHIFT -> BW20 (+3 dB SNR boost for deep fade)\n");
                        deep_fade_ticks = 0;
                        strong_signal_ticks = 0;
                        settle_ticks = 2;
                    }
                } else {
                    deep_fade_ticks = 0;
                }
            } else {
                /* In BW20: upshift to BW40 if signal strongly recovered */
                if (p_median >= 22 && q_phase >= 75) {
                    strong_signal_ticks++;
                    if (strong_signal_ticks >= 20) { /* Persisted continuously for 1.0s */
                        s_current_bw40 = true;
                        apply_rf_bandwidth(true); /* UPSHIFT to BW40 (restore full color!) */
                        printf("[GEARBOX] UPSHIFT -> BW40 (Signal recovered, full color restored)\n");
                        strong_signal_ticks = 0;
                        deep_fade_ticks = 0;
                        settle_ticks = 2;
                    }
                } else {
                    strong_signal_ticks = 0;
                }
            }
            }
        } else if (s_bw_gear_mode == BW_GEAR_BW40) {
            if (!s_current_bw40) {
                s_current_bw40 = true;
                apply_rf_bandwidth(true);
            }
        } else if (s_bw_gear_mode == BW_GEAR_BW20) {
            if (s_current_bw40) {
                s_current_bw40 = false;
                apply_rf_bandwidth(false);
            }
        }

        /* 5. Experimental AFC.
         * Default is OFF: mean WBFM phase slope over a 6.4 us window includes
         * video modulation and is NOT a calibrated absolute carrier offset.
         * AUTO remains an explicit test mode only.
         * Locked = frozen RF: while the legacy lock holds, AUTO tracking
         * holds too (afc_ticks reset), so no offset write fires mid-lock and
         * tracking re-arms with a fresh 1 s persistence after unlock rather
         * than bursting a stale-CFO write. The OFF-mode convergence below is
         * a settled one-shot mode-alignment write and stays writable. */
        if (s_afc_mode == AFC_MODE_AUTO) {
            /* Only adjust if carrier is strongly locked (Q_phase >= 75%) and gain settled */
            if (q_phase >= 75 && p_median >= 18 && settle_ticks == 0 && !s_legacy_lock_confirmed) {
                /* Centering deadband: +/- 35 kHz. Inside deadband = 0 register writes */
                if (s_cfo_khz > 35 || s_cfo_khz < -35) {
                    afc_ticks++;
                    if (afc_ticks >= 20) { /* Persisted for 1.0 second */
                        int cur_offset = rf_get_frequency_offset_khz();
                        int target_offset = cur_offset + s_cfo_khz;
                        apply_frequency_offset_khz_tracked(target_offset);
                        afc_ticks = 0;
                        settle_ticks = 2;
                    }
                } else {
                    afc_ticks = 0;
                }
            } else {
                afc_ticks = 0; /* Frozen during noise, deep fades, or legacy lock: NO drifting away! */
            }
        } else if (s_afc_mode == AFC_MODE_OFF) {
            if (rf_get_frequency_offset_khz() != 0) {
                apply_frequency_offset_khz_tracked(0);
            }
        }

        /* OUI-SPY menu guard: while the native menu raster owns the TX chain,
         * keep the lock/scan state machines, buzzer cadence, LED heartbeat
         * and the periodic [AGC:...] telemetry paused -- exactly the freeze
         * behavior from before the range port. The gain controller above
         * still ran while the menu was up, so nothing is stale on exit. */
        if (!menu_active_now) {
        /* 6. Carrier Lock Detection with hysteresis + release debounce.
         * ACQUIRE is strict: Q_phase >= 55% + full envelope/modulation
         * discrimination. HOLD is tolerant: Q_phase >= 40% + envelope only,
         * so a few windows landing on sync/blanking never drop an established
         * lock. Release requires the hold condition to fail for 500 ms.
         * Carrier-offset verification: a lock whose measured CFO sits more
         * than half the tightest channel spacing (9.5 MHz) from the tuned
         * center is an adjacent-channel image, not this channel -- refuse
         * to declare (the scanner keeps/resumes hopping via the normal lost
         * path and the scan-stop watchdog) and drop an established lock if
         * the offset drifts beyond it. Log once per event. */
        /* Fast strong-signal declare: a single tick clearly above the blip
         * threshold (p_median >= 20, clean envelope, coherent) declares
         * IMMEDIATELY without waiting for the 8-tick vote count -- that
         * accumulation (plus cross-channel vote smear after hops) was the
         * remaining declare latency. Marginal signals still take the proven
         * vote path; the carrier-offset verification applies to both. */
        const bool lock_strong_now = peak_now && (p_median >= 20) && (q_phase >= 55);
        const bool carrier_offset_ok =
            s_cfo_khz <= LOCK_MAX_OFFSET_KHZ && s_cfo_khz >= -LOCK_MAX_OFFSET_KHZ;
        static bool s_lock_reject_logged;
        /* Legacy predicate (unchanged): AGC state + carrier-offset
         * verification + vote-qualified acquire / tolerant hold. The
         * effective lock is legacy OR grabber (video reality) -- see the
         * grabber input above. The offset verification stays legacy-only:
         * the grabber sees decoded composite, which is on-channel by
         * definition once it syncs. */
        const bool legacy_lock_raw = (s_agc_state != AGC_STATE_SEARCH) && carrier_offset_ok &&
                        (was_locked ? (q_phase >= 40 && envelope_ok)
                                    : ((q_phase >= 55 && carrier_ok) || lock_strong_now));
        bool lock_raw = legacy_lock_raw || grabber_locked;
        if (!carrier_offset_ok && !s_lock_reject_logged &&
            (s_agc_state != AGC_STATE_SEARCH) &&
            (was_locked ? (q_phase >= 40 && envelope_ok)
                        : ((q_phase >= 55 && carrier_ok) || lock_strong_now))) {
            /* Everything else about this signal says lock, but the carrier
             * is off-channel: reject and say why (once per event). */
            s_lock_reject_logged = true;
            printf("[LOCK] rejected: carrier %+d kHz off %s\n",
                   s_cfo_khz, rf_get_current_channel()->name);
        }
        if (carrier_offset_ok) s_lock_reject_logged = false;
        if (lock_raw) {
            unlock_ticks = 0;
        } else if (unlock_ticks < 10) {
            unlock_ticks++;
        }
        bool is_locked = was_locked ? (unlock_ticks < 10) : lock_raw;

        /* Sound/UI split (user choice: instant over conservative):
         * - The LOCK jingle and [CARRIER] Locked print fire the moment the
         *   detector first declares lock (is_locked rising edge) -- no 500 ms
         *   hold for the sound. The vote-based declaration above is unchanged,
         *   so noise immunity is exactly as before.
         * - The 500 ms sustain (lock_confirmed) still gates the foxhunt
         *   proximity cadence, the solid LED, the LOST-chirp history, and
         *   the RF-freeze mirror. A lock that dies before 500 ms gets the
         *   jingle but no falling chirp and no foxhunt run. */
        static int lock_hold = 0;
        static bool was_confirmed = false;
        if (is_locked) {
            if (lock_hold < 1000) lock_hold++;
        } else {
            lock_hold = 0;
        }
        bool lock_confirmed = is_locked && lock_hold >= 10; /* 10 x 50 ms */
        s_legacy_lock_confirmed = lock_confirmed;
        if (is_locked != was_locked && !is_locked) {
            /* OSINT episode telemetry: end-of-episode carrier/decoder facts
             * for the detection CSV. The host appends cfo_ppm, video_std and
             * line_us columns; emit BEFORE [CARRIER] Lost so it is attributed
             * to the still-open episode. Blank when a fact is unknown
             * (video_std undecided, grabber never locked). */
            float line_us = 0.0f;
            const bool line_ok = preview_get_line_us(&line_us);
            const float cfo_ppm = (float)s_cfo_khz * 1000.0f /
                                  (float)rf_get_current_channel()->freq_mhz;
            printf("[EPISODE] cfo_ppm=%+.1f video_std=%s line_us=",
                   cfo_ppm, s_detected_video_std_valid ?
                   (s_detected_video_std == VIDEO_STD_PAL ? "PAL" : "NTSC") : "");
            if (line_ok) printf("%.2f", line_us);
            printf("\n");
            printf("[CARRIER] Lost (Q=%d%%, env=%s, mod=%s, P_med=%d)\n",
                   q_phase, envelope_ok ? "ok" : "noise",
                   modulation_ok ? "ok" : "cw?", p_median);
            if (was_confirmed) {
                buzzer_event(BUZZER_EVENT_LOST);
            }
            if (s_scan_auto && !s_scan_mode) {
                s_scan_mode = true;
                s_agc_state = AGC_STATE_SEARCH;
                s_scan_ticks = 0; /* fresh dwell on auto-resume */
                s_scan_dwell_extended = false;
                printf("[SCAN] AUTO - resuming 48-channel hop\n");
            }
        }
        if (is_locked && !was_locked) { /* instant declare transition */
            buzzer_event(BUZZER_EVENT_LOCK); /* 3 ascending beeps: detected, real */
            const fpv_channel_t *ch = rf_get_current_channel();
            printf("[CARRIER] Locked on %s (%u MHz) in %s (P_med=%d, Q_phase=%d%%, G=%u)\n",
                   ch->name, ch->freq_mhz, rf_get_band_name(rf_get_current_band()),
                   p_median, q_phase, s_current_gain);
        }
        was_locked = is_locked;
        was_confirmed = lock_confirmed;

        /* Scan-stop watchdog: the scanner parks on a candidate, but only the
         * full lock detector may confirm it. If no lock within 3 s, the
         * candidate was a transient -> resume hopping instead of parking
         * forever on a dead channel. */
        if (scan_confirm >= 0) {
            if (is_locked || !s_scan_auto) {
                scan_confirm = -1;
            } else if (++scan_confirm >= 60) { /* 60 x 50 ms = 3 s */
                scan_confirm = -1;
                s_scan_mode = true;
                s_agc_state = AGC_STATE_SEARCH;
                s_scan_ticks = 0; /* fresh dwell on watchdog resume */
                s_scan_dwell_extended = false;
                printf("[SCAN] Candidate not confirmed, resuming hop\n");
            }
        }

        /* 7. Buzzer: unified proximity cadence + onboard status LED.
         *
         * PRE-LOCK DETECTION CADENCE (field-ready instant feedback): while
         * NOT confirmed-locked, any tick with a real peak (peak_now -- the
         * proven never-fire-on-static triple check) drives the SAME
         * level->cadence mapping the post-lock foxhunt uses, so a pilot
         * walking in hears the proximity sound from the FIRST strong tick
         * and the sound is continuous across the lock handoff. Dead ticks
         * (hopping, no peak) silence via the task's disabled path
         * (interval < 0). A very strong first tick maps to a short
         * interval, i.e. a near-instant beep -- nothing the old fixed blip
         * provided is lost. Suppressed on the tick a hop happens
         * (just_hopped: PHY re-tune transients must not sound).
         *
         * POST-LOCK foxhunt cadence is the settled behavior, unchanged,
         * now through the shared helper. Gate strictly on the debounced
         * carrier lock: at max search gain, thermal noise alone keeps
         * P_median above the SEARCH exit threshold (the classic noise
         * trap); noise cannot sustain FM coherence or the peak predicate.
         * No carrier = buzzer SILENT; heartbeat on the LED.
         *
         * Event paths are untouched: buzzer_event (jingle/LOST) is handled
         * before proximity each pass in the buzzer task and resets its
         * proximity timing, so the lock jingle plays clean and the cadence
         * (pre- or post-lock) resumes immediately after it. At most one
         * buzzer_set_proximity call per tick. */
        bool carrier_present = lock_confirmed;
        if (!carrier_present && peak_now && !just_hopped) {
            buzzer_proximity_for_level(level_db);   /* pre-lock detection cadence */
        } else if (carrier_present) {
            buzzer_proximity_for_level(level_db);   /* post-lock foxhunt cadence */
        } else {
            buzzer_set_proximity(-1, 0);            /* silence: interval < 0 disables */
        }
        /* LED semantics unchanged: SCAN while hopping, heartbeat when
         * parked without a confirmed lock, solid when locked. */
        if (s_scan_mode) {
            status_led_set(STATUS_LED_SCAN);
        } else if (!carrier_present) {
            status_led_set(STATUS_LED_HEARTBEAT);   /* orange LED heartbeat instead */
        } else {
            status_led_set(STATUS_LED_SOLID);
        }
        status_led_tick();
        } /* !menu_active_now */


update_telemetry:
        if (!menu_active_now) {
        telemetry_ticks++;
        if (telemetry_ticks >= 4) { /* 5 Hz periodic telemetry log (HUD meters) */
            telemetry_ticks = 0;
            const fpv_channel_t *ch = rf_get_current_channel();
            int cur_off = rf_get_frequency_offset_khz();
            int total_khz = (int)ch->freq_mhz * 1000 + cur_off;
            printf("[AGC:%s] %-5s BW=%-4s | %s:%d.%03dMHz %+4dkHz (CFO=%+4d kHz) | G=%u | P=%-2d Q=%2d%% | c=%-2d | L=%2d.%ddB\n",
                   (s_agc_mode == ANALOG_AGC_ACTIVE) ? "ACT" :
                   (s_agc_mode == ANALOG_AGC_SHADOW) ? "SHD" : "MAN",
                   (s_agc_state == AGC_STATE_TRACK) ? "TRACK" :
                   (s_agc_state == AGC_STATE_LEARN) ? "LEARN" : "SRCH",
                   s_current_bw40 ? "BW40" : "BW20",
                   ch->name,
                   total_khz / 1000,
                   (total_khz % 1000 >= 0 ? total_khz % 1000 : -(total_khz % 1000)),
                   cur_off,
                   s_cfo_khz,
                   s_current_gain,
                   s_last_p_median, s_last_q_phase, s_last_n_clip,
                   s_last_level_dbc / 10, s_last_level_dbc % 10);
        }
        }
    }
}

static void console_diag_task(void *arg)
{
    (void)arg;
    /* Two-byte direct tune: 't' arms, the NEXT byte is channel index 0..47
     * (band*8+channel: R1=0, A1=8, B1=16, E1=24, F1=32, L1=40). The pending
     * flag expires after ~2 s so a stray 't' cannot eat a later keystroke. */
    static bool s_tune_pending;
    static unsigned s_tune_ticks;

    for (;;) {
        /* IDF 6.0's O_NONBLOCK VFS read consults the installed driver's
         * available-byte count even in no-driver mode. Poll the FIFO here;
         * this task is its sole reader. Bound each batch so paste cannot
         * monopolize the task. No host line-ending or DTR assumption. */
        for (unsigned received = 0; received < 64; ++received) {
            uint8_t byte;
            if (usb_serial_jtag_ll_read_rxfifo(&byte, 1) == 0) break;
            int c = byte;
            if (s_tune_pending) {
                s_tune_pending = false;
                if (c < 48) {
                    esp_err_t terr = rf_set_channel((size_t)c);
                    if (terr == ESP_OK) {
                        s_cfo_khz = 0;
                        s_agc_state = AGC_STATE_SEARCH;
                        video_standard_detector_reset();
                        buzzer_event(BUZZER_EVENT_TICK);
                        const fpv_channel_t *ch = rf_get_current_channel();
                        printf("[TUNE] -> %s (%u MHz) in %s\n",
                               ch->name, ch->freq_mhz,
                               rf_get_band_name(rf_get_current_band()));
                    } else {
                        printf("[TUNE] FAILED index %d (%s)\n", c, esp_err_to_name(terr));
                    }
                } else {
                    printf("[TUNE] ERROR: channel index %d out of range (0..47)\n", c);
                }
            } else if (c != EOF && c > 0) {
                if (c == '+') {
                    s_agc_mode = ANALOG_AGC_MANUAL;
                    if (s_current_gain < 62u) s_current_gain += 2u;
                    apply_rx_gain_tracked(s_current_gain);
                    printf("[MANUAL GAIN] = %u (reg=0x%08lx)\n", s_current_gain, (unsigned long)rf_get_rx_gain_reg());
                } else if (c == '-' || c == 'j') {
                    s_agc_mode = ANALOG_AGC_MANUAL;
                    if (s_current_gain >= 2u) s_current_gain -= 2u;
                    apply_rx_gain_tracked(s_current_gain);
                    printf("[MANUAL GAIN] = %u (reg=0x%08lx)\n", s_current_gain, (unsigned long)rf_get_rx_gain_reg());
                } else if (c == 'a') {
                    s_agc_mode = ANALOG_AGC_ACTIVE;
                    printf("[AGC MODE] -> ACTIVE (Self-Calibrating Adaptive Gain Controller ACTIVE)\n");
                } else if (c == 's') {
                    s_agc_mode = ANALOG_AGC_SHADOW;
                    printf("[AGC MODE] -> SHADOW (Dry-run: RF gain frozen at %u, computing recommendations)\n", s_current_gain);
                } else if (c == 'm') {
                    s_agc_mode = ANALOG_AGC_MANUAL;
                    printf("[AGC MODE] -> MANUAL (Fixed gain=%u)\n", s_current_gain);
                } else if (c == 'b') {
                    if (s_bw_gear_mode == BW_GEAR_AUTO) {
                        s_bw_gear_mode = BW_GEAR_BW40;
                        s_current_bw40 = true;
                        apply_rf_bandwidth(true);
                        printf("[BW GEAR] -> FORCED BW40 (Full color / 20 MHz baseband)\n");
                    } else if (s_bw_gear_mode == BW_GEAR_BW40) {
                        s_bw_gear_mode = BW_GEAR_BW20;
                        s_current_bw40 = false;
                        apply_rf_bandwidth(false);
                        printf("[BW GEAR] -> FORCED BW20 (+3 dB SNR Long-Range Survival mode)\n");
                    } else {
                        s_bw_gear_mode = BW_GEAR_AUTO;
                        printf("[BW GEAR] -> AUTO GEARBOX (Dynamic Bandwidth Adaptation)\n");
                    }
                } else if (c == 'c') {
                    rf_cycle_channel_in_band();
                    const fpv_channel_t *ch = rf_get_current_channel();
                    s_cfo_khz = 0;
                    s_agc_state = AGC_STATE_SEARCH;
                    video_standard_detector_reset();
                    buzzer_event(BUZZER_EVENT_TICK);
                    printf("[CHANNEL] Switched to %s (%u MHz) in %s\n",
                           ch->name, ch->freq_mhz, rf_get_band_name(rf_get_current_band()));
                } else if (c == 'C') {
                    rf_cycle_band();
                    const fpv_channel_t *ch = rf_get_current_channel();
                    s_cfo_khz = 0;
                    s_agc_state = AGC_STATE_SEARCH;
                    video_standard_detector_reset();
                    buzzer_event(BUZZER_EVENT_BAND);
                    printf("[BAND] Switched to %s - Channel %s (%u MHz)\n",
                           rf_get_band_name(rf_get_current_band()), ch->name, ch->freq_mhz);
                } else if (c == 'u') {
                    buzzer_set_enabled(!buzzer_is_enabled());
                    printf("[AUDIO] Buzzer %s\n", buzzer_is_enabled() ? "ENABLED" : "MUTED");
                } else if (c == 'g') {
                    s_scan_mode = !s_scan_mode;
                    s_scan_auto = s_scan_mode;
                    if (s_scan_mode) {
                        s_agc_state = AGC_STATE_SEARCH;
                        s_scan_ticks = 0; /* fresh dwell on scan start */
                        s_scan_dwell_extended = false;
                        printf("[SCAN] ON - hopping all 48 channels until a carrier is found\n");
                    } else {
                        printf("[SCAN] OFF - staying on %s (%u MHz) (auto-resume disabled)\n",
                               rf_get_current_channel()->name, rf_get_current_channel()->freq_mhz);
                    }
                } else if (c == 'k') {
                    s_skip_dead = !s_skip_dead;
                    unsigned parked = 0;
                    for (size_t i = 0; i < FPV_BAND_COUNT * 8u; ++i) {
                        if (s_chan_miss[i] >= SKIP_DEAD_MISS_THRESHOLD) ++parked;
                    }
                    printf("[SWEEP] dead-channel skip %s (%u channels parked)\n",
                           s_skip_dead ? "ON" : "OFF", parked);
                } else if (c == 'f') {
                    if (s_afc_mode == AFC_MODE_AUTO) {
                        s_afc_mode = AFC_MODE_HOLD;
                        printf("[AFC] -> HOLD (Current offset %+d kHz frozen)\n", rf_get_frequency_offset_khz());
                    } else if (s_afc_mode == AFC_MODE_HOLD) {
                        s_afc_mode = AFC_MODE_OFF;
                        apply_frequency_offset_khz_tracked(0);
                        printf("[AFC] -> OFF (Offset reset to 0 kHz)\n");
                    } else {
                        s_afc_mode = AFC_MODE_AUTO;
                        printf("[AFC] -> AUTO EXPERIMENTAL (uncalibrated WBFM bias estimator)\n");
                    }
                } else if (c == ',' || c == '<') {
                    step_frequency_offset_khz_tracked(-50);
                    int off = rf_get_frequency_offset_khz();
                    int tot = (int)rf_get_current_channel()->freq_mhz * 1000 + off;
                    printf("[FINE TUNE] Offset = %+d kHz (Tuned: %d.%03d MHz)\n",
                           off, tot / 1000, (tot % 1000 >= 0 ? tot % 1000 : -(tot % 1000)));
                } else if (c == '.' || c == '>') {
                    step_frequency_offset_khz_tracked(+50);
                    int off = rf_get_frequency_offset_khz();
                    int tot = (int)rf_get_current_channel()->freq_mhz * 1000 + off;
                    printf("[FINE TUNE] Offset = %+d kHz (Tuned: %d.%03d MHz)\n",
                           off, tot / 1000, (tot % 1000 >= 0 ? tot % 1000 : -(tot % 1000)));
                } else if (c == '0') {
                    apply_frequency_offset_khz_tracked(0);
                    printf("[FINE TUNE] Offset reset to +0 kHz\n");
                } else if (c == 'e') {
                    PARL_IO.rx_clk_cfg.rx_clk_i_inv = !PARL_IO.rx_clk_cfg.rx_clk_i_inv;
                    printf("[EDGE] RX SAMPLE EDGE TOGGLED -> %s (rx_clk_i_inv=%d)\n",
                           PARL_IO.rx_clk_cfg.rx_clk_i_inv ? "NEG" : "POS",
                           (int)PARL_IO.rx_clk_cfg.rx_clk_i_inv);
                } else if (c == 't') {
                    s_tune_pending = true;
                    s_tune_ticks = 0;
                    printf("[TUNE] armed: send channel index byte (0..47 = R1..L8)\n");
                } else if (c == 'p') {
                    /* Preview is always on: swallow the key (and the web
                     * toggle's 'p' byte) so it cannot fall through to the
                     * diagnostics dump below. There is no way to stop the
                     * preview from the console. */
                } else if (c == 'T') {
                    demod_toggle_traj();
                } else if (c == 'l' || c == 'L') {
                    /* f30297b: user-visible lag/freeze mark for issue #28
                     * correlation against PHY writes and transport faults. */
                    int64_t now = esp_timer_get_time();
                    s_last_user_lag_mark_us = now;
                    ++s_hw_counters.user_lag_mark_count;
                    long long gain_age_ms = s_last_gain_write_us > 0 ?
                        (long long)((now - s_last_gain_write_us) / 1000) : -1;
                    long long transport_age_ms = s_last_transport_event_us > 0 ?
                        (long long)((now - s_last_transport_event_us) / 1000) : -1;
                    long long phy_age_ms = s_last_phy_write_us > 0 ?
                        (long long)((now - s_last_phy_write_us) / 1000) : -1;
                    printf("[LAG MARK] #%lu gain_age=%lldms phy_age=%lldms phy_kind=%u transport_age=%lldms flags=0x%02lx G=%u state=%u\n",
                           (unsigned long)s_hw_counters.user_lag_mark_count,
                           gain_age_ms, phy_age_ms, (unsigned)s_last_phy_write_kind, transport_age_ms,
                           (unsigned long)s_last_transport_flags,
                           s_current_gain, (unsigned)s_agc_state);
                } else if (c == 'o' || c == 'v' || c == 'V' || c == 'O' ||
                           c == ' ' || c == 'n' || c == '\t' ||
                           c == '\r' || c == '\n' || c == 'x') {
                    /* The control task exclusively owns mode changes and rendering. */
                    if (xQueueSend(s_menu_commands, &c, 0) != pdTRUE) {
                        printf("[MENU] Command queue full\n");
                    }
                } else {
                    uint32_t rx_dscr = 0, tx_dscr = 0;
                    uint32_t rx_off = get_rx_dma_offset(&rx_dscr);
                    uint32_t tx_off = get_tx_dma_offset(&tx_dscr);
                    uint32_t dist = (rx_off >= tx_off) ? (rx_off - tx_off) : (sizeof(s_raw_ring) - tx_off + rx_off);
                    int rx_nodes = s_rx_dscr_count;
                    int tx_nodes = s_menu_active ? 0 : s_tx_dscr_count;
                    const fpv_channel_t *ch = rf_get_current_channel();
                    int off = rf_get_frequency_offset_khz();
                    int tot = (int)ch->freq_mhz * 1000 + off;

                    printf("\n=======================================================\n");
                    printf(" C5VRX-3 REALTIME RECEPTION & FREQUENCY DIAGNOSTICS\n");
                    printf(" Receiver Channel:           %s (%u MHz)\n", ch->name, ch->freq_mhz);
                    printf(" Tuned Frequency:            %d.%03d MHz (Offset: %+d kHz)\n",
                           tot / 1000, (tot % 1000 >= 0 ? tot % 1000 : -(tot % 1000)), off);
                    printf(" Carrier Frequency Offset:   %+d kHz (VTX %s)\n",
                           s_cfo_khz, (s_cfo_khz > 20) ? "high" : (s_cfo_khz < -20) ? "low" : "centered");
                    printf(" AFC Mode:                   %s\n",
                           (s_afc_mode == AFC_MODE_AUTO) ? "AUTO EXPERIMENTAL (uncalibrated estimator)" :
                           (s_afc_mode == AFC_MODE_HOLD) ? "HOLD (Offset Frozen)" : "OFF (0 kHz)");
                    printf(" Bandwidth Gear:             %s (Current: %s)\n",
                           (s_bw_gear_mode == BW_GEAR_AUTO) ? "AUTO (Dynamic Adaptation)" :
                           (s_bw_gear_mode == BW_GEAR_BW40) ? "FORCED BW40" : "FORCED BW20",
                           s_current_bw40 ? "BW40 (Wide / Color)" : "BW20 (Narrow / +3 dB Survival)");
                    printf(" Adaptive AGC Mode:          %s (State=%s)\n",
                           (s_agc_mode == ANALOG_AGC_ACTIVE) ? "ACTIVE" :
                           (s_agc_mode == ANALOG_AGC_SHADOW) ? "SHADOW (Safe Dry-Run)" : "MANUAL",
                           (s_agc_state == AGC_STATE_TRACK) ? "TRACK" :
                           (s_agc_state == AGC_STATE_LEARN) ? "LEARN" : "SEARCH");
                    printf(" Gain Settings:              G_actual=%u, G_shadow_rec=%u (reg=0x%08lx)\n",
                           s_current_gain, s_shadow_gain, (unsigned long)rf_get_rx_gain_reg());
                    printf(" FM Vector Metrics:          P_median=%d, Q_phase=%d%%, Clip=%d, Origin=%d\n",
                           s_last_p_median, s_last_q_phase, s_last_n_clip, s_last_n_origin);
                    printf(" IQ Frontend Metrics:        DC I=%+.2f Q=%+.2f, skew=%d.%d%% cross=%d.%d%%\n",
                           (double)s_last_dc_i_x100 / 100.0, (double)s_last_dc_q_x100 / 100.0,
                           s_last_iq_skew_permille / 10, s_last_iq_skew_permille % 10,
                           s_last_iq_cross_permille / 10, s_last_iq_cross_permille % 10);
                    printf(" Demod Quality:              endpoint winding=%d.%d%% strong=%d.%d%% syncQ=%d width=%u age=%dt\n",
                           s_last_winding_permille / 10, s_last_winding_permille % 10,
                           s_last_strong_winding_permille / 10, s_last_strong_winding_permille % 10,
                           s_last_sync_quality, (unsigned)s_last_sync_width_20m,
                           s_last_sync_age_ticks);
                    printf(" Carrier Level:              %d.%d dB (calibrated, ~45 dB full scale)\n",
                           s_last_level_dbc / 10, s_last_level_dbc % 10);
                    printf(" GDMA Ring:                  dist=%lu (rx_off=%lu, tx_off=%lu)\n",
                           (unsigned long)dist, (unsigned long)rx_off, (unsigned long)tx_off);
                    printf(" Zero-EOF Status:            RX patched=%d nodes, TX patched=%d nodes\n",
                           rx_nodes, tx_nodes);
                    printf(" Transport Faults:           PARLIO tx_empty=%lu rx_ovf=%lu tx_eof=%lu | GDMA in=%lu out=%lu | BS eof_ovl=%lu\n",
                           (unsigned long)s_hw_counters.parl_tx_rempty_count,
                           (unsigned long)s_hw_counters.parl_rx_wovf_count,
                           (unsigned long)s_hw_counters.parl_tx_eof_count,
                           (unsigned long)s_hw_counters.gdma_in_fault_count,
                           (unsigned long)s_hw_counters.gdma_out_fault_count,
                           (unsigned long)s_hw_counters.bs_eof_overload_count);
                    int64_t transport_age_ms = s_last_transport_event_us > 0 ?
                        (esp_timer_get_time() - s_last_transport_event_us) / 1000 : -1;
                    printf(" Lag Correlation:            events=%lu near_gain_200ms=%lu near_phy_200ms=%lu gain_Qdrop=%lu marks=%lu last_flags=0x%02lx age=%lldms checks=%lu\n",
                           (unsigned long)s_hw_counters.lag_event_count,
                           (unsigned long)s_hw_counters.near_gain_event_count,
                           (unsigned long)s_hw_counters.near_phy_event_count,
                           (unsigned long)s_hw_counters.gain_quality_drop_count,
                           (unsigned long)s_hw_counters.user_lag_mark_count,
                           (unsigned long)s_last_transport_flags,
                           (long long)transport_age_ms,
                           (unsigned long)s_hw_counters.checks);
                    unsigned available = s_lag_event_head < LAG_EVENT_LOG_SIZE ?
                                         s_lag_event_head : LAG_EVENT_LOG_SIZE;
                    for (unsigned n = 0; n < available; ++n) {
                        uint32_t seq = s_lag_event_head - n;
                        const lag_event_t *event = &s_lag_events[(seq - 1u) % LAG_EVENT_LOG_SIZE];
                        printf("  EVT#%lu flags=0x%02lx t=%lldus rx=%u tx=%u G%u state=%u\n",
                               (unsigned long)event->seq,
                               (unsigned long)event->flags,
                               (long long)event->time_us,
                               event->rx_off, event->tx_off,
                               event->gain, event->agc_state);
                    }
                    printf(" Gain Transitions:           %lu (control window=%u IQ samples / %.1f us)\n",
                           (unsigned long)s_gain_transition_count, CONTROL_SAMPLE_BYTES,
                           (double)CONTROL_SAMPLE_BYTES * 1000000.0 / (double)IQ_RATE_HZ);
                    printf(" RX Sample Edge:             %s (rx_clk_i_inv=%d)\n",
                           PARL_IO.rx_clk_cfg.rx_clk_i_inv ? "NEG" : "POS",
                           (int)PARL_IO.rx_clk_cfg.rx_clk_i_inv);
                    printf(" Menu Standard:              %s (%s)\n",
                           (s_video_std == VIDEO_STD_PAL) ? "PAL 625i" : "NTSC 525i",
                           (s_video_std == VIDEO_STD_PAL) ? "50Hz, 625 lines/frame" : "59.94Hz, 525 lines/frame");
                    printf(" Detected Standard:          %s (period=%u samples, PAL votes=%u NTSC votes=%u)\n",
                           s_detected_video_std_valid ? video_standard_name(s_detected_video_std) : "searching",
                           (unsigned)s_last_line_period_20m,
                           (unsigned)s_video_std_pal_score, (unsigned)s_video_std_ntsc_score);
                    printf(" Menu Status:                %s (BOOT button trigger: %s)\n",
                           s_menu_active ? "OPEN" : "CLOSED",
                           s_menu_boot_btn_enabled ? "ENABLED" : "DISABLED (Safe Flight Mode)");
                    printf(" Keys:\n");
                    printf("  'a'/'s'/'m': AGC mode (active / shadow / manual)\n");
                    printf("  '+' / '-':   Manual gain step (+/-2)\n");
                    printf("  'b':         Bandwidth gear (auto / forced bw40 / forced bw20)\n");
                    printf("  'c':         Cycle FPV channel (A1..A8, R1..R8, B1..B8, F1..F8)\n");
                    printf("  'f':         AFC mode (auto-centering / hold / off)\n");
                    printf("  ',' / '.':   Fine-tune offset (-50 / +50 kHz)\n");
                    printf("  '0':         Reset offset to 0 kHz\n");
                    printf("  'e':         Toggle RX sample edge (POS/NEG)\n");
                    printf("  'u':         Toggle buzzer (foxhunt proximity audio) on/off\n");
                    printf("  'g':         Toggle channel scanner (ON at boot; auto-resumes after lost carrier)\n");
                    printf("  'k':         Toggle dead-channel skip (fast 50 ms dwell on parked channels)\n");
                    printf("  't' + byte:  Direct channel tune (index 0..47: R1=0, A1=8, B1=16, E1=24, F1=32, L1=40)\n");
                    printf("  'p':         (no-op) USB video preview is always on\n");
                    printf("  'T':         A/B demod switch (Phase5 <-> Trajectory v2)\n");
                    printf("  'l':         Mark a visible lag/freeze for PHY-write correlation\n");
                    printf("  'v':         Toggle Video Standard (NTSC 525i / PAL 625i)\n");
                    printf("  'o':         Toggle menu via console\n");
                    printf("  'O':         Toggle BOOT button menu trigger (Safe Flight Mode)\n");
                    printf("  'd':         Print this diagnostic summary\n");
                    printf("=======================================================\n\n");
                }
            }
        }
        if (s_tune_pending && ++s_tune_ticks >= 200) { /* ~2 s at 10 ms poll */
            s_tune_pending = false;
            printf("[TUNE] timed out (no index byte)\n");
        }
        vTaskDelay(pdMS_TO_TICKS(10));
    }
}


/* ----- Main entry point ----- */

esp_err_t video_start(void)
{
    /* Keep output unbuffered on the no-driver USB VFS. Input is drained directly
     * by console_diag_task; USB is never involved in DMA sample pacing. */
    setvbuf(stdin, NULL, _IONBF, 0);
    setvbuf(stdout, NULL, _IONBF, 0);
    int flags = fcntl(fileno(stdin), F_GETFL, 0);
    fcntl(fileno(stdin), F_SETFL, flags | O_NONBLOCK);
    flags = fcntl(fileno(stdout), F_GETFL, 0);
    fcntl(fileno(stdout), F_SETFL, flags | O_NONBLOCK);
    usb_serial_jtag_vfs_use_nonblocking();

    /* Initialize BOOT button on GPIO 28 */
    init_boot_button();

    /* OUI-SPY buzzer on GPIO25 (D2 pad). Q[8] IQ lane moved to GPIO2/MTMS.
     * Boot beep greets power-on; after that the buzzer only speaks for
     * signal events (lock/lost/foxhunt) and explicit button presses. */
    if (buzzer_init() == ESP_OK) {
        buzzer_event(BUZZER_EVENT_BOOT);
    }

    /* XIAO onboard user LED (GPIO27): heartbeat/scan/lock indicator. */
    status_led_init();
    for (int i = 0; i < 3; i++) {   /* boot flourish: 3 quick blinks */
        status_led_set(STATUS_LED_SOLID);
        vTaskDelay(pdMS_TO_TICKS(120));
        status_led_set(STATUS_LED_OFF);
        vTaskDelay(pdMS_TO_TICKS(120));
    }

    /* Menu control is serialized with BOOT handling in the AGC task. */
    s_menu_commands = xQueueCreate(16, sizeof(int));
    if (!s_menu_commands) return ESP_ERR_NO_MEM;

    /* Zero the ring before starting. Flush to DMA-visible SRAM. */
    memset(s_raw_ring, 0, sizeof(s_raw_ring));
    sync_dma_c2m(s_raw_ring, sizeof(s_raw_ring));

    esp_err_t err;

    if ((err = prepare_rx()) != ESP_OK) return err;
    if ((err = prepare_tx()) != ESP_OK) return err;

    start_flight_demodulator();

    /* Start RX cyclic ring. GDMA begins writing at s_raw_ring[0]. */
    if ((err = start_rx()) != ESP_OK) return err;

    /* Put PARLIO RX into pure continuous hardware mode:
     * 1. Disable all GDMA RX channel interrupts so the CPU is never interrupted
     *    (~9,775 ISRs/sec eliminated!).
     * 2. Set rx_eof_gen_sel = 1 (external enable, non-existent in soft mode)
     *    so PARLIO RX never generates an EOF stall event.
     * This matches PARLIO TX's unbroken hardware loop, eliminating pointer drift! */
    AHB_DMA.in_intr[0].ena.val = 0;
    AHB_DMA.in_intr[1].ena.val = 0;
    AHB_DMA.in_intr[2].ena.val = 0;
    PARL_IO.rx_genrl_cfg.rx_eof_gen_sel = 1;

    /* Request half-ring producer/consumer separation before starting TX.
     * The integer-microsecond delay and driver latency need hardware validation. */
    esp_rom_delay_us(8192ULL * 1000000ULL / IQ_RATE_HZ);

    if ((err = start_tx()) != ESP_OK) return err;

    /* Discover AHB_DMA channels connected to PARLIO. The trigger number comes
     * from the SoC header (SOC_GDMA_TRIG_PERIPH_PARLIO0 = 9 on ESP32-C5)
     * instead of a hardcoded literal. Fallback: PARLIO is the only peripheral
     * wired to AHB GDMA in this design, so accept any channel already
     * connected to a nonzero peripheral rather than leaving the tap blind. */
    for (int i = 0; i < 3; i++) {
        if (AHB_DMA.channel[i].in.in_peri_sel.peri_in_sel_chn ==
            SOC_GDMA_TRIG_PERIPH_PARLIO0) {
            s_rx_dma_ch = i;
        }
        if (AHB_DMA.channel[i].out.out_peri_sel.peri_out_sel_chn ==
            SOC_GDMA_TRIG_PERIPH_PARLIO0) {
            s_tx_dma_ch = i;
        }
    }
    if (s_rx_dma_ch < 0 || s_tx_dma_ch < 0) {
        for (int i = 0; i < 3; i++) {
            if (s_rx_dma_ch < 0 &&
                AHB_DMA.channel[i].in.in_peri_sel.peri_in_sel_chn != 0) {
                s_rx_dma_ch = i;
            }
            if (s_tx_dma_ch < 0 &&
                AHB_DMA.channel[i].out.out_peri_sel.peri_out_sel_chn != 0) {
                s_tx_dma_ch = i;
            }
        }
        printf("[GDMA] PARLIO trigger %d not found on any channel; "
               "fallback scan -> rx_ch=%d tx_ch=%d\n",
               SOC_GDMA_TRIG_PERIPH_PARLIO0, s_rx_dma_ch, s_tx_dma_ch);
    }
    if (s_rx_dma_ch < 0 || s_tx_dma_ch < 0) {
        printf("[GDMA] WARNING: no PARLIO DMA channel found "
               "(rx_ch=%d tx_ch=%d) - IQ tap and EOF patch disabled\n",
               s_rx_dma_ch, s_tx_dma_ch);
    }

    /* Put PARLIO TX into pure continuous hardware mode:
     * Disable all GDMA TX channel interrupts and PARL_IO core interrupts.
     * Prevents PARLIO_LL_EVENT_TX_FIFO_EMPTY and EOF interrupts from stealing CPU cycles! */
    AHB_DMA.out_intr[0].ena.val = 0;
    AHB_DMA.out_intr[1].ena.val = 0;
    AHB_DMA.out_intr[2].ena.val = 0;
    PARL_IO.int_ena.val = 0;

    /* Clear suc_eof on ALL GDMA descriptors for both RX and TX to eliminate
     * hardware wrap EOF bubbles completely! The buffer becomes a truly infinite ring. */
    int rx_nodes = patch_descriptors_clear_eof(s_rx_dma_ch, true);
    int tx_nodes = patch_descriptors_clear_eof(s_tx_dma_ch, false);

    /* f30297b: clear stale startup/driver sticky status once so the first
     * poll_transport_faults() observation is truthful. */
    PARL_IO.int_clr.val = UINT32_MAX;
    if (s_rx_dma_ch >= 0) AHB_DMA.in_intr[s_rx_dma_ch].clr.val = UINT32_MAX;
    if (s_tx_dma_ch >= 0) AHB_DMA.out_intr[s_tx_dma_ch].clr.val = UINT32_MAX;
    BITSCRAMBLER.state[BITSCRAMBLER_DIR_TX].val = 1u << 31;

    /* Start interactive console for on-demand diagnostics (zero periodic CPU/bus traffic) */
    xTaskCreate(console_diag_task, "console_diag", 3072, NULL, 1, NULL);

    /* Start dedicated Analog Video AGC engine (P_median in [20, 30], fast attack) */
    xTaskCreate(analog_agc_task, "analog_agc", 8192, NULL, 3, NULL);

    /* USB preview side-tap: creates the task already enabled (always on).
     * Never fatal -- if task creation fails the preview simply stays off. */
    (void)preview_init();


    /* Print startup stamp (visible on serial monitor at boot). */
    ESP_EARLY_LOGW(TAG,
        "\n=======================================================\n"
        " C5VRX-3  Seamless 16K Phase5 receiver (Zero-EOF Circular GDMA)\n"
        " Clock:   PARLIO_CLK_SRC_DEFAULT 40MHz (SPLL internal)\n"
        " Telemetry: Live GDMA ring pointer tracking (rx_ch=%d, tx_ch=%d)\n"
        " Buffer:  16,384 bytes cyclic ring (Zero-EOF patched: RX=%d TX=%d)\n"
        " RX:      40 MS/s POS edge, 16,384 bytes pure HW cyclic GDMA\n"
        " Demod:   Phase5 50ns / P%u / G%u / current-minus-previous\n"
        " TX:      40 MHz [D,D] / eof=downstream / tail=0\n"
        " Lock:    GDMA ISRs disabled, RX EOF disabled, suc_eof=0 cleared\n"
        " CPU:     done (hardware runs in unbroken infinite loop)\n"
        "=======================================================\n",
        s_rx_dma_ch, s_tx_dma_ch, rx_nodes, tx_nodes, DAC_IDLE_CODE, 2u);

    /* Preview is always on: enabled inside preview_init() above; this is
     * an idempotent re-assert. The ON print stays after the startup stamp
     * so the host supervisor sees boot-reset before stream-on. */
    preview_set_enabled(true);
    if (preview_is_enabled()) {
        ESP_LOGW(TAG, "[PREVIEW] ON - 224x168 GRAY8 row stream started (row packets on console)");
    } else {
        ESP_LOGW(TAG, "[PREVIEW] not enabled at boot - preview unavailable (init failed)");
    }

    return ESP_OK;
}
